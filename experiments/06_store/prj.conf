## CMakeLists.txt
```
#
# Copyright (c) 2026 Conexio Technologies, Inc
#
# SPDX-License-Identifier: Apache-2.0
#

cmake_minimum_required(VERSION 3.20.0)

find_package(Zephyr REQUIRED HINTS $ENV{ZEPHYR_BASE})
project(nrplus_exp_store)

target_sources(app PRIVATE
  src/main.c
  src/sf_codec.c
  src/sf_dedup.c
  src/sf_store.c
  src/sf_link.c
  src/sf_node.c
  src/sf_port.c
  src/sf_shell.c
  src/sf_persist.c
)

target_include_directories(app PRIVATE src)
```

## Kconfig
```
#
# Copyright (c) 2026 Conexio Technologies, Inc
#
# SPDX-License-Identifier: Apache-2.0
#

menu "DECT NR+ store-and-forward"

config CARRIER
	int "Carrier number"
	default 0
	help
	  Required. Set this in overlay-us.conf or overlay-eu.conf.
	  Band index 1 is used only for carriers 525..551.
	  This is build-time because it is a regulatory choice, not a lab knob.

config NETWORK_ID
	int "DECT network id"
	range 1 4294967295
	default 91
	help
	  Build-time. Both the PHY header short id and the modem network id
	  use this value. Do not change it on one board only.

config TX_POWER
	int "Default TX power index (0..13)"
	range 0 13
	default 10
	help
	  Starting value for exp sett power. Not dBm. Overlays may override it.
	  Runtime changes apply to the next transmission.

config MCS
	int "Default MCS"
	range 0 7
	default 0
	help
	  Starting value for exp sett mcs. Experiment 05 (performance) measured MCS 0 up to 249 bytes.

config SF_PHY_MTU
	int "Maximum PHY payload (bytes)"
	range 32 249
	default 249
	help
	  Total on-air application PDU, header included. 249 is the size that
	  Experiment 05 put on the air at MCS 0. The 16-byte protocol header is inside
	  this budget, so the largest application payload is MTU - 16.

config SF_RX_FILTER_ID
	int "PHY RX filter receiver identity"
	range 0 65535
	default 0
	help
	  0 accepts every receiver identity (broadcast filter), matching 03_topology.

config SF_HARQ_RX_PROCESSES
	int "Modem HARQ RX process count"
	range 1 8
	default 4

config SF_HARQ_RX_EXPIRY_US
	int "Modem HARQ RX expiry (microseconds)"
	default 5000000

config SF_DEVICE_ID_OVERRIDE
	bool "Override the hardware device id"
	default n

config SF_DEVICE_ID
	int "Device id override"
	depends on SF_DEVICE_ID_OVERRIDE
	range 1 65534
	default 1
	help
	  Normally the id is the first two bytes from hwinfo, the same value
	  03_topology prints. Override only for a bench that must use fixed ids.

choice SF_DEFAULT_ROLE
	prompt "Role after boot (before a saved profile)"
	default SF_ROLE_SOURCE

config SF_ROLE_SOURCE
	bool "source"

config SF_ROLE_RELAY
	bool "relay"

config SF_ROLE_SINK
	bool "sink"

endchoice

config SF_DEST_ID
	int "Default destination id"
	range 0 65535
	default 0
	help
	  0 means unset. A source will not start until exp sett dest or a profile.

config SF_PAYLOAD_LEN
	int "Default application payload (bytes)"
	range 1 233
	default 64
	help
	  This is the application payload, not the on-air frame.
	  The frame is this value plus the 16-byte header.
	  It must fit CONFIG_SF_SMALL_PAYLOAD, or the large pool when that is enabled.

config SF_INTERVAL_MS
	int "Default source period (ms)"
	range 0 600000
	default 1000
	help
	  0 turns the periodic generator off. Use exp alarm, or set a period.
	  This is different from 03_topology, where 0 still sent as fast as the loop.

config SF_COUNT
	int "Default packet count (0 = until stop)"
	range 0 4294967295
	default 0

config SF_HELLO_MS
	int "Default HELLO period (ms, 0 = off)"
	range 0 600000
	default 2000

config SF_TTL
	int "Default hop limit"
	range 1 16
	default 5

config SF_DIRECT_FALLBACK
	bool "If no route entry, send straight to the destination id"
	default y
	help
	  Turn off when the source must be forced through exp route.
	  Runtime: exp sett direct on|off. A saved profile overrides this default.

config SF_ASSUME_UP
	bool "Treat a new next hop as UP without probing"
	default n
	help
	  Off matches the protocol rule that a link becomes UP only after N probes.
	  Turn on for a bench that should move data immediately.
	  Runtime: exp sett assume_up on|off.

config SF_DEDUPE
	bool "Drop duplicate deliveries"
	default y
	help
	  Off delivers every copy. Leave it on unless you are deliberately
	  testing the duplicate path. Runtime: exp sett dedup on|off.

config SF_GEN_CLASS_ALARM
	bool "Periodic generator sends alarm instead of telemetry"
	default n

choice SF_DEFAULT_POLICY
	prompt "Telemetry overflow policy"
	default SF_POLICY_REJECT

config SF_POLICY_REJECT
	bool "reject (ACK QUEUE_FULL, sender keeps the packet)"

config SF_POLICY_DROP_OLDEST
	bool "drop oldest telemetry already in this store"

endchoice

config SF_HELLO_TX_ON
	bool "Send HELLO even from a source"
	default n
	help
	  When off, HELLO follows the role: relay and sink send it, source does not.
	  Runtime exp sett hello_tx auto|on|off replaces this.

menu "Store capacity"

config SF_SMALL_SLOTS
	int "Small-pool slots"
	range 1 512
	default 320
	help
	  Telemetry capacity is (slots - alarm reserved). At 1 packet/s,
	  320 slots with 32 reserved is about 288 seconds of backlog.
	  Raise this only after a ram_report. Each slot costs the payload
	  size plus about 32 bytes of metadata.

config SF_SMALL_PAYLOAD
	int "Small-pool payload capacity (bytes)"
	range 1 233
	default 64

config SF_SMALL_ALARM_SLOTS
	int "Small slots reserved for alarm"
	range 0 512
	default 32
	help
	  Telemetry cannot use these. Alarm can use any free slot.
	  Must be <= CONFIG_SF_SMALL_SLOTS.

config SF_LARGE_SLOTS
	int "Large-pool slots"
	range 0 96
	default 0
	help
	  Leave at 0 until a test sends payloads above the small-pool size.
	  Each slot is CONFIG_SF_LARGE_PAYLOAD bytes plus metadata.

config SF_LARGE_PAYLOAD
	int "Large-pool payload capacity (bytes)"
	range 1 233
	default 233

config SF_LARGE_ALARM_SLOTS
	int "Large slots reserved for alarm"
	range 0 96
	default 0

endmenu

menu "ARQ, listen, and link"

config SF_ACK_TIMEOUT_MS
	int "ACK wait after TX (ms)"
	range 1 5000
	default 200
	help
	  Provisional. A relay that is itself waiting for a downstream ACK
	  can delay the upstream ACK by about this long. Measure RTT on a
	  clean 1-hop run, then lower it with exp sett ack_timeout.
	  Do not start from the spec's 40 ms until that capture exists.

config SF_MAX_ATTEMPTS
	int "Transmissions before the link is declared DOWN"
	range 1 8
	default 4
	help
	  Counts the first send. 4 means one send plus three retries.
	  The packet stays in the store.

config SF_BACKOFF_MIN_MS
	int "Minimum retry backoff (ms)"
	range 0 1000
	default 10

config SF_BACKOFF_MAX_MS
	int "Maximum of the first retry window (ms)"
	range 0 5000
	default 20

config SF_BACKOFF_CAP_MS
	int "Backoff window cap (ms)"
	range 0 10000
	default 80

config SF_NACK_HOLDOFF_MS
	int "Holdoff after QUEUE_FULL or NO_ROUTE (ms)"
	range 0 60000
	default 1000
	help
	  Doubled when the ACK reports queue_free = 0.

config SF_INTER_TX_LISTEN_MS
	int "Listen gap after a completed exchange (ms)"
	range 0 1000
	default 20

config SF_RX_SLICE_MS
	int "Idle receive slice (ms)"
	range 1 500
	default 15
	help
	  An ACK is sent at the end of the slice that received the frame,
	  so this is the worst-case extra ACK delay while idle.
	  Stop also waits out the current slice.

config SF_HELLO_DEAD_MS
	int "DOWN if a neighbour that has HELLO'd goes silent (ms, 0 = off)"
	range 0 600000
	default 7000
	help
	  Applied only after at least one HELLO from that next hop.
	  A peer with HELLO disabled does not kill the link.

config SF_T_PROBE_MS
	int "Probe timer while DOWN (ms)"
	range 0 60000
	default 3000

config SF_PROBE_FAST_MS
	int "Gap between successful probes (ms)"
	range 1 5000
	default 200

config SF_N_UP
	int "Consecutive probe replies required before UP"
	range 1 8
	default 3

config SF_HOLDDOWN_MIN_MS
	int "First hold-down after UP to DOWN (ms)"
	range 0 60000
	default 5000

config SF_HOLDDOWN_MAX_MS
	int "Hold-down cap (ms)"
	range 0 120000
	default 60000

config SF_HOLDDOWN_RESET_MS
	int "Stable UP time that clears the hold-down streak (ms)"
	range 0 600000
	default 60000

config SF_TELEMETRY_TTL_MS
	int "Drop stored telemetry older than this (ms, 0 = never)"
	range 0 86400000
	default 600000

config SF_STREAM_IDLE_MS
	int "Forget a dedup stream after this idle time (ms, 0 = never)"
	range 0 86400000
	default 1800000

config SF_ALARM_RATE
	int "Alarm token rate (per second)"
	range 0 100
	default 5

config SF_ALARM_BURST
	int "Alarm token burst"
	range 1 100
	default 10

config SF_ROUTE_MAX
	int "Route table entries"
	range 1 8
	default 4

config SF_LINK_MAX
	int "Next-hop link entries"
	range 1 8
	default 4

config SF_MAX_STREAMS
	int "Dedup streams"
	range 1 16
	default 16

config SF_NEIGH_MAX
	int "Neighbour table entries"
	range 1 8
	default 8

config SF_ACK_QUEUE
	int "ACKs that can be waiting to transmit"
	range 1 8
	default 4

config SF_RX_QUEUE
	int "Receive messages queued from the modem callback"
	range 2 16
	default 8

endmenu

config SF_OP_TIMEOUT_MS
	int "Give up on a modem TX/RX operation after (ms)"
	range 100 10000
	default 2000
	help
	  The modem operation is then cancelled and the run stops.
	  This is a hang guard, not the ACK timer.

config SF_RADIO_STACK
	int "Radio thread stack (bytes)"
	default 8192
	help
	  The radio thread builds a full frame (up to the PHY MTU) on the
	  stack while another copy is waiting for the modem. 8192 covers that
	  plus the log call. Lower it only after a stack report.

config SF_BOOT_LOOP_MAX
	int "Boots inside the guard window before radio start is delayed"
	range 1 20
	default 5

config SF_BOOT_DELAY_CAP_S
	int "Maximum boot-loop radio delay (seconds)"
	range 0 60
	default 60

config SF_BOOT_STABLE_S
	int "Continuous run that clears the boot-loop counter (seconds)"
	range 1 3600
	default 300
	help
	  There is no RTC, so "5 minutes of boots" is approximated by
	  counting boots until the node has been running this long.

config SF_SHELL
	bool "exp shell"
	default y
	select SHELL
	select SHELL_BACKEND_SERIAL

config SF_WAIT_FOR_START
	bool "Wait for exp start unless a profile enables autostart"
	default y
	depends on SF_SHELL

config SF_PERSIST
	bool "Save profile and boot epoch in settings/NVS"
	default y
	depends on SF_SHELL
	select SETTINGS
	select NVS
	select FLASH
	select FLASH_MAP
	help
	  exp save stores the profile. The boot epoch is a separate key and
	  is not erased by exp factory. CONFIG_SETTINGS_NVS is a choice
	  symbol; prj.conf sets it.

endmenu

module = SF
module-str = store-and-forward
source "$(ZEPHYR_BASE)/subsys/logging/Kconfig.template.log_config"

menu "Zephyr Kernel"
source "Kconfig.zephyr"
endmenu
```

## prj.conf
```kconfig
CONFIG_NRF_MODEM_LIB=y
CONFIG_MODEM_ANTENNA=n
CONFIG_NRF_MODEM_LINK_BINARY_DECT_PHY=y
CONFIG_HWINFO=y

CONFIG_LOG=y
CONFIG_LOG_MODE_DEFERRED=y
CONFIG_LOG_BUFFER_SIZE=32768
CONFIG_SF_LOG_LEVEL_INF=y

CONFIG_BOOTLOADER_MCUBOOT=y

CONFIG_SF_SHELL=y
CONFIG_SF_WAIT_FOR_START=y
CONFIG_SF_PERSIST=y
CONFIG_SHELL_STACK_SIZE=3072
CONFIG_SHELL_CMD_BUFF_SIZE=256

CONFIG_FLASH=y
CONFIG_FLASH_MAP=y
CONFIG_FLASH_PAGE_LAYOUT=y
CONFIG_MPU_ALLOW_FLASH_WRITE=y
CONFIG_NVS=y
CONFIG_SETTINGS=y
CONFIG_SETTINGS_NVS=y
CONFIG_PM_PARTITION_SIZE_SETTINGS_STORAGE=0x4000

# Sensor Integration (DHT11)
CONFIG_SENSOR=y
CONFIG_DHT=y
CONFIG_CBPRINTF_FP_SUPPORT=y
```

## boards/conexio_stratus_pro_nrf9151.overlay
```dts
/ {
	dht11: dht11 {
		compatible = "aosong,dht";
		status = "okay";
		/* Conexio Stratus Pro V1.4 - D2 is typically P0.2 or similar,
		   but feather header standard applies. Update as needed! */
		dio-gpios = <&gpio0 2 (GPIO_PULL_UP | GPIO_ACTIVE_LOW)>;
	};
};
```

## src/main.c
```c
/*
 * Copyright (c) 2026 Conexio Technologies, Inc
 *
 * SPDX-License-Identifier: Apache-2.0
 *
 * Modem bring-up and the half-duplex radio thread.
 * Protocol decisions live in sf_node.c. This file only moves frames.
 */

#include "sf_port.h"

#include <string.h>

#include <zephyr/drivers/hwinfo.h>
#include <zephyr/kernel.h>
#include <zephyr/logging/log.h>
#include <modem/nrf_modem_lib.h>
#include <nrf_modem_dect_phy.h>

LOG_MODULE_DECLARE(app, CONFIG_SF_LOG_LEVEL);

#define TX_HANDLE 0u
#define RX_HANDLE 1u

static bool phy_fatal;
static uint64_t modem_time;
/* Written by the modem callback immediately before it gives op_sem. */
static volatile int op_result;

struct phy_ctrl_field_common {
	uint32_t packet_length : 4;
	uint32_t packet_length_type : 1;
	uint32_t header_format : 3;
	uint32_t short_network_id : 8;
	uint32_t transmitter_id_hi : 8;
	uint32_t transmitter_id_lo : 8;
	uint32_t df_mcs : 3;
	uint32_t reserved : 1;
	uint32_t transmit_power : 4;
	uint32_t pad : 24;
};

K_SEM_DEFINE(op_sem, 0, 4);

static void sem_give(void)
{
	(void)k_sem_give(&op_sem);
}

static void on_init(const struct nrf_modem_dect_phy_init_event *evt)
{
	if (evt->err) {
		LOG_ERR("phy init %d", evt->err);
		phy_fatal = true;
	}
	sem_give();
}

static void on_deinit(const struct nrf_modem_dect_phy_deinit_event *evt)
{
	ARG_UNUSED(evt);
	sem_give();
}

static void on_activate(const struct nrf_modem_dect_phy_activate_event *evt)
{
	if (evt->err) {
		LOG_ERR("phy activate %d", evt->err);
		phy_fatal = true;
	}
	sem_give();
}

static void on_deactivate(const struct nrf_modem_dect_phy_deactivate_event *evt)
{
	ARG_UNUSED(evt);
	sem_give();
}

static void on_configure(const struct nrf_modem_dect_phy_configure_event *evt)
{
	if (evt->err) {
		LOG_ERR("phy configure %d", evt->err);
		phy_fatal = true;
	}
	sem_give();
}

static bool op_succeeded(int err)
{
	return err == NRF_MODEM_DECT_PHY_SUCCESS || err == NRF_MODEM_DECT_PHY_OK_WITH_HARQ_RESET;
}

static void on_op_complete(const struct nrf_modem_dect_phy_op_complete_event *evt)
{
	op_result = (int)evt->err;
	if (!op_succeeded(op_result)) {
		LOG_WRN("phy op handle %u err %d", evt->handle, op_result);
	}
	sem_give();
}

static void on_cancel(const struct nrf_modem_dect_phy_cancel_event *evt)
{
	ARG_UNUSED(evt);
	sem_give();
}

static void on_pdc(const struct nrf_modem_dect_phy_pdc_event *evt)
{
	sf_port_on_pdc(evt->data, evt->len, (int16_t)evt->rssi_2);
}

static void dect_phy_event_handler(const struct nrf_modem_dect_phy_event *evt)
{
	modem_time = evt->time;
	switch (evt->id) {
	case NRF_MODEM_DECT_PHY_EVT_INIT:
		on_init(&evt->init);
		break;
	case NRF_MODEM_DECT_PHY_EVT_DEINIT:
		on_deinit(&evt->deinit);
		break;
	case NRF_MODEM_DECT_PHY_EVT_ACTIVATE:
		on_activate(&evt->activate);
		break;
	case NRF_MODEM_DECT_PHY_EVT_DEACTIVATE:
		on_deactivate(&evt->deactivate);
		break;
	case NRF_MODEM_DECT_PHY_EVT_CONFIGURE:
		on_configure(&evt->configure);
		break;
	case NRF_MODEM_DECT_PHY_EVT_COMPLETED:
		on_op_complete(&evt->op_complete);
		break;
	case NRF_MODEM_DECT_PHY_EVT_CANCELED:
		on_cancel(&evt->cancel);
		break;
	case NRF_MODEM_DECT_PHY_EVT_PDC:
		on_pdc(&evt->pdc);
		break;
	case NRF_MODEM_DECT_PHY_EVT_PDC_ERROR:
	case NRF_MODEM_DECT_PHY_EVT_PCC_ERROR:
		LOG_DBG("phy crc error t=%" PRIu64, modem_time);
		break;
	case NRF_MODEM_DECT_PHY_EVT_PCC:
	case NRF_MODEM_DECT_PHY_EVT_RSSI:
	case NRF_MODEM_DECT_PHY_EVT_RADIO_CONFIG:
	case NRF_MODEM_DECT_PHY_EVT_TIME:
	case NRF_MODEM_DECT_PHY_EVT_CAPABILITY:
	case NRF_MODEM_DECT_PHY_EVT_BANDS:
	case NRF_MODEM_DECT_PHY_EVT_LATENCY:
	case NRF_MODEM_DECT_PHY_EVT_LINK_CONFIG:
	case NRF_MODEM_DECT_PHY_EVT_STF_CONFIG:
	case NRF_MODEM_DECT_PHY_EVT_TEST_RF_TX_CW_CONTROL_CONFIG:
	default:
		break;
	}
}

/*
 * Type-1 PHY header packet_length codes used by 03_topology and the 05_performance
 * 249-byte captures. This is a modem header field, not an application setting.
 */
static uint8_t phy_len_code(uint16_t len)
{
	if (len <= 32) {
		return 0x03;
	}
	if (len <= 64) {
		return 0x07;
	}
	return 0x0F;
}

static int transmit(struct phy_ctrl_field_common *header, const uint8_t *data, uint16_t len,
		   uint8_t power, uint8_t mcs)
{
	struct nrf_modem_dect_phy_tx_params tx;

	memset(header, 0, sizeof(*header));
	header->header_format = 0x0;
	header->packet_length_type = 0x0;
	header->packet_length = phy_len_code(len);
	header->short_network_id = (CONFIG_NETWORK_ID & 0xff);
	header->transmitter_id_hi = (uint8_t)(sf_port_node_id() >> 8);
	header->transmitter_id_lo = (uint8_t)(sf_port_node_id() & 0xff);
	header->transmit_power = power;
	header->df_mcs = mcs;

	memset(&tx, 0, sizeof(tx));
	tx.start_time = 0;
	tx.handle = TX_HANDLE;
	tx.network_id = CONFIG_NETWORK_ID;
	tx.phy_type = 0;
	tx.lbt_rssi_threshold_max = 0;
	tx.carrier = CONFIG_CARRIER;
	tx.lbt_period = NRF_MODEM_DECT_LBT_PERIOD_MAX;
	tx.phy_header = (union nrf_modem_dect_phy_hdr *)header;
	tx.data = (uint8_t *)data;
	tx.data_size = len;
	return nrf_modem_dect_phy_tx(&tx);
}

static int receive(uint32_t duration_ms)
{
	struct nrf_modem_dect_phy_rx_params rx = {
		.start_time = 0,
		.handle = RX_HANDLE,
		.network_id = CONFIG_NETWORK_ID,
		.mode = NRF_MODEM_DECT_PHY_RX_MODE_CONTINUOUS,
		.rssi_interval = NRF_MODEM_DECT_PHY_RSSI_INTERVAL_OFF,
		.link_id = NRF_MODEM_DECT_PHY_LINK_UNSPECIFIED,
		.rssi_level = -60,
		.carrier = CONFIG_CARRIER,
		.duration = duration_ms * NRF_MODEM_DECT_MODEM_TIME_TICK_RATE_KHZ,
		.filter.short_network_id = CONFIG_NETWORK_ID & 0xff,
		.filter.is_short_network_id_used = 1,
		.filter.receiver_identity = CONFIG_SF_RX_FILTER_ID,
	};

	return nrf_modem_dect_phy_rx(&rx);
}

static int wait_boot(void)
{
	k_sem_take(&op_sem, K_FOREVER);
	return phy_fatal ? -EIO : 0;
}

static int wait_op(uint32_t handle)
{
	int rc = k_sem_take(&op_sem, K_MSEC(CONFIG_SF_OP_TIMEOUT_MS));
	int result;

	if (rc != 0) {
		LOG_ERR("modem operation %u timed out", handle);
		(void)nrf_modem_dect_phy_cancel(handle);
		(void)k_sem_take(&op_sem, K_MSEC(500));
		while (k_sem_take(&op_sem, K_NO_WAIT) == 0) {
		}
		return -ETIMEDOUT;
	}
	result = op_result;
	while (k_sem_take(&op_sem, K_NO_WAIT) == 0) {
	}
	if (op_succeeded(result)) {
		return 0;
	}
	LOG_WRN("modem operation %u finished err %d", handle, result);
	return -EIO;
}

static void drain_sem(void)
{
	while (k_sem_take(&op_sem, K_NO_WAIT) == 0) {
	}
}

static void radio_thread(void *p1, void *p2, void *p3)
{
	ARG_UNUSED(p1);
	ARG_UNUSED(p2);
	ARG_UNUSED(p3);

	while (1) {
		sf_port_wait_until_started();
		while (sf_port_running()) {
			struct sf_action act;
			struct phy_ctrl_field_common header;
			uint8_t buf[CONFIG_SF_PHY_MTU];
			uint8_t power;
			uint8_t mcs;
			int err;

			sf_port_note_stable_if_due();
			sf_port_poll(&act);
			if (!sf_port_running()) {
				break;
			}
			if (act.kind == SF_ACT_TX) {
				if (act.tx_len == 0 || act.tx_len > sizeof(buf)) {
					sf_port_on_tx_done(false, act.inflight);
					continue;
				}
				memcpy(buf, act.tx, act.tx_len);
				sf_port_radio(&power, &mcs);
				drain_sem();
				err = transmit(&header, buf, act.tx_len, power, mcs);
				if (err != 0) {
					LOG_ERR("tx submit %d", err);
					sf_port_on_tx_done(false, act.inflight);
					continue;
				}
				err = wait_op(TX_HANDLE);
				if (err == -ETIMEDOUT) {
					sf_port_stop("modem_timeout");
					break;
				}
				/* LBT busy, bad header, or a rejected op: the frame did not
				 * leave the radio. Count the attempt and keep listening.
				 */
				sf_port_on_tx_done(err == 0, act.inflight);
			} else {
				uint32_t slice = act.rx_ms == 0 ? 1u : act.rx_ms;

				drain_sem();
				err = receive(slice);
				if (err != 0) {
					LOG_ERR("rx submit %d", err);
					sf_port_stop("rx_error");
					break;
				}
				err = wait_op(RX_HANDLE);
				if (err == -ETIMEDOUT) {
					sf_port_stop("modem_timeout");
					break;
				}
				if (err != 0) {
					LOG_ERR("rx operation failed");
					sf_port_stop("rx_error");
					break;
				}
				sf_port_drain_rx();
			}
		}
	}
}

static K_THREAD_STACK_DEFINE(radio_stack, CONFIG_SF_RADIO_STACK);
static struct k_thread radio_thread_data;

static uint16_t read_device_id(void)
{
	uint16_t id = 0;

#if IS_ENABLED(CONFIG_SF_DEVICE_ID_OVERRIDE)
	id = (uint16_t)CONFIG_SF_DEVICE_ID;
#else
	(void)hwinfo_get_device_id((uint8_t *)&id, sizeof(id));
#endif
	return id;
}

static int boot_phy(void)
{
	static const struct nrf_modem_dect_phy_config_params params = {
		.band_group_index = ((CONFIG_CARRIER >= 525 && CONFIG_CARRIER <= 551)) ? 1 : 0,
		.harq_rx_process_count = CONFIG_SF_HARQ_RX_PROCESSES,
		.harq_rx_expiry_time_us = CONFIG_SF_HARQ_RX_EXPIRY_US,
	};
	int err;

	err = nrf_modem_lib_init();
	if (err != 0) {
		LOG_ERR("modem lib %d", err);
		return err;
	}
	err = nrf_modem_dect_phy_event_handler_set(dect_phy_event_handler);
	if (err != 0) {
		LOG_ERR("phy handler %d", err);
		return err;
	}
	err = nrf_modem_dect_phy_init();
	if (err != 0 || wait_boot() != 0) {
		LOG_ERR("phy init failed");
		return err != 0 ? err : -EIO;
	}
	err = nrf_modem_dect_phy_configure(&params);
	if (err != 0 || wait_boot() != 0) {
		LOG_ERR("phy configure failed");
		return err != 0 ? err : -EIO;
	}
	err = nrf_modem_dect_phy_activate(NRF_MODEM_DECT_PHY_RADIO_MODE_LOW_LATENCY);
	if (err != 0 || wait_boot() != 0) {
		LOG_ERR("phy activate failed");
		return err != 0 ? err : -EIO;
	}
	return 0;
}

int main(void)
{
	int err;

	sf_port_boot(read_device_id());
	err = boot_phy();
	if (err != 0) {
		return err;
	}
	k_thread_create(&radio_thread_data, radio_stack, CONFIG_SF_RADIO_STACK, radio_thread, NULL,
			NULL, NULL, 5, 0, K_NO_WAIT);
	k_thread_name_set(&radio_thread_data, "sf_radio");
	LOG_INF("shell: exp status|sett|route|start|stop|sf|link|neigh|alarm|save|load");
	if (sf_port_autostart_ok()) {
		err = sf_port_start(0);
		if (err != 0) {
			LOG_WRN("autostart failed %d", err);
		}
	} else {
		LOG_INF("idle — exp start");
	}
	return 0;
}
```

## src/sf_codec.c
```c
/*
 * Copyright (c) 2026 Conexio Technologies, Inc
 *
 * SPDX-License-Identifier: Apache-2.0
 */

#include "sf_codec.h"

#include <string.h>

static void put_u16(uint8_t *p, uint16_t v)
{
	p[0] = (uint8_t)(v & 0xffu);
	p[1] = (uint8_t)((v >> 8) & 0xffu);
}

static uint16_t get_u16(const uint8_t *p)
{
	return (uint16_t)p[0] | ((uint16_t)p[1] << 8);
}

const char *sf_role_name(uint8_t role)
{
	switch (role) {
	case SF_ROLE_SOURCE:
		return "source";
	case SF_ROLE_RELAY:
		return "relay";
	case SF_ROLE_SINK:
		return "sink";
	default:
		return "invalid";
	}
}

const char *sf_class_name(uint8_t class_)
{
	switch (class_) {
	case SF_CLASS_TEL:
		return "tel";
	case SF_CLASS_ALARM:
		return "alarm";
	default:
		return "rsv";
	}
}

const char *sf_ack_name(uint8_t status)
{
	switch (status) {
	case SF_ACK_ACCEPTED:
		return "ACCEPTED";
	case SF_ACK_DUPLICATE:
		return "DUPLICATE";
	case SF_ACK_QUEUE_FULL:
		return "QUEUE_FULL";
	case SF_ACK_TTL_EXPIRED:
		return "TTL_EXPIRED";
	case SF_ACK_NO_ROUTE:
		return "NO_ROUTE";
	case SF_ACK_PROBE_REPLY:
		return "PROBE_REPLY";
	default:
		return "UNKNOWN";
	}
}

const char *sf_link_name(uint8_t state)
{
	switch (state) {
	case SF_LINK_DOWN:
		return "DOWN";
	case SF_LINK_PROBING:
		return "PROBING";
	case SF_LINK_UP:
		return "UP";
	default:
		return "INVALID";
	}
}

const char *sf_type_name(uint8_t type)
{
	switch (type) {
	case SF_TYPE_DATA:
		return "DATA";
	case SF_TYPE_HELLO:
		return "HELLO";
	case SF_TYPE_ACK:
		return "ACK";
	case SF_TYPE_PROBE:
		return "PROBE";
	default:
		return "UNKNOWN";
	}
}

static uint16_t min_len(uint8_t type)
{
	switch (type) {
	case SF_TYPE_DATA:
	case SF_TYPE_PROBE:
		return SF_HDR_LEN;
	case SF_TYPE_HELLO:
		return SF_HELLO_LEN;
	case SF_TYPE_ACK:
		return SF_ACK_LEN;
	default:
		return 0;
	}
}

int sf_codec_encode(const struct sf_frame *f, uint8_t *out, size_t cap, uint16_t phy_mtu)
{
	uint16_t need;
	uint8_t flags;

	if (f == NULL || out == NULL || f->ver != SF_PROTO_VERSION) {
		return -SF_CODEC_RANGE;
	}
	need = min_len(f->type);
	if (need == 0) {
		return -SF_CODEC_TYPE;
	}
	if (f->type == SF_TYPE_DATA) {
		need = (uint16_t)(SF_HDR_LEN + f->payload_len);
	}
	if (need > phy_mtu || need > cap || f->payload_len > SF_PAYLOAD_MAX) {
		return -SF_CODEC_MTU;
	}

	flags = (uint8_t)(f->flags & (uint8_t)~(0x0cu | SF_FLAG_RETX | SF_FLAG_SEC));
	flags = (uint8_t)(flags | ((f->class_ & 0x3u) << 2));
	if (f->retx) {
		flags |= SF_FLAG_RETX;
	}
	if (f->type == SF_TYPE_DATA) {
		flags |= SF_FLAG_CUSTODY;
	}

	memset(out, 0, need);
	out[0] = (uint8_t)((SF_PROTO_VERSION << 4) | (f->type & 0x0fu));
	out[1] = flags;
	put_u16(&out[2], f->src);
	put_u16(&out[4], f->dst);
	put_u16(&out[6], f->prev);
	put_u16(&out[8], f->next);
	put_u16(&out[10], f->seq);
	put_u16(&out[12], f->epoch);
	out[14] = f->hops;
	out[15] = f->ttl;
	put_u16(&out[16], f->payload_len);

	if (f->type == SF_TYPE_DATA && f->payload_len > 0) {
		memcpy(&out[SF_HDR_LEN], f->payload, f->payload_len);
	} else if (f->type == SF_TYPE_HELLO) {
		out[18] = f->role;
		out[19] = f->free_pct;
	} else if (f->type == SF_TYPE_ACK) {
		out[18] = f->status;
		put_u16(&out[19], f->queue_free);
		put_u16(&out[21], f->node_epoch);
	}
	return (int)need;
}

int sf_codec_decode(const uint8_t *in, size_t len, uint16_t phy_mtu, struct sf_frame *f)
{
	uint8_t type;
	uint16_t need;

	if (in == NULL || f == NULL) {
		return -SF_CODEC_RANGE;
	}
	memset(f, 0, sizeof(*f));
	if (len < SF_HDR_LEN) {
		return -SF_CODEC_SHORT;
	}
	if (len > phy_mtu || len > SF_PAYLOAD_MAX) {
		return -SF_CODEC_MTU;
	}
	f->ver = (uint8_t)(in[0] >> 4);
	type = (uint8_t)(in[0] & 0x0fu);
	if (f->ver != SF_PROTO_VERSION) {
		return -SF_CODEC_VERSION;
	}
	if ((in[1] & SF_FLAG_SEC) != 0) {
		return -SF_CODEC_SEC;
	}
	need = min_len(type);
	if (need == 0) {
		return -SF_CODEC_TYPE;
	}
	if (len < need) {
		return -SF_CODEC_SHORT;
	}

	f->type = type;
	f->flags = in[1];
	f->class_ = (uint8_t)((in[1] >> 2) & 0x3u);
	f->retx = (in[1] & SF_FLAG_RETX) != 0;
	f->src = get_u16(&in[2]);
	f->dst = get_u16(&in[4]);
	f->prev = get_u16(&in[6]);
	f->next = get_u16(&in[8]);
	f->seq = get_u16(&in[10]);
	f->epoch = get_u16(&in[12]);
	f->hops = in[14];
	f->ttl = in[15];
	f->payload_len = get_u16(&in[16]);

	if (type == SF_TYPE_DATA) {
		if (SF_HDR_LEN + f->payload_len > len) {
			return -SF_CODEC_SHORT;
		}
		if (f->payload_len > 0) {
			memcpy(f->payload, &in[SF_HDR_LEN], f->payload_len);
		}
		if ((in[1] & SF_FLAG_CUSTODY) == 0) {
			return -SF_CODEC_RANGE;
		}
	} else if (type == SF_TYPE_HELLO) {
		f->role = in[18];
		f->free_pct = in[19];
	} else if (type == SF_TYPE_ACK) {
		f->status = in[18];
		f->queue_free = get_u16(&in[19]);
		f->node_epoch = get_u16(&in[21]);
	}
	return SF_CODEC_OK;
}
```

## src/sf_codec.h
```c
/*
 * Copyright (c) 2026 Conexio Technologies, Inc
 *
 * SPDX-License-Identifier: Apache-2.0
 *
 * Field-by-field codec. Callers never cast a received buffer to a struct.
 */

#ifndef SF_CODEC_H_
#define SF_CODEC_H_

#include "sf_types.h"

#include <stddef.h>

enum sf_codec_err {
	SF_CODEC_OK = 0,
	SF_CODEC_SHORT = 1,
	SF_CODEC_VERSION = 2,
	SF_CODEC_TYPE = 3,
	SF_CODEC_SEC = 4,
	SF_CODEC_MTU = 5,
	SF_CODEC_RANGE = 6,
};

int sf_codec_encode(const struct sf_frame *f, uint8_t *out, size_t cap, uint16_t phy_mtu);
int sf_codec_decode(const uint8_t *in, size_t len, uint16_t phy_mtu, struct sf_frame *f);

#endif /* SF_CODEC_H_ */
```

## src/sf_dedup.c
```c
/*
 * Copyright (c) 2026 Conexio Technologies, Inc
 *
 * SPDX-License-Identifier: Apache-2.0
 */

#include "sf_dedup.h"

void sf_dedup_init(struct sf_dedup *d)
{
	unsigned int i;

	for (i = 0; i < SF_STREAM_CAP; i++) {
		d->item[i].used = false;
	}
	d->evictions = 0;
	d->gaps = 0;
	d->stale_epoch = 0;
	d->dups = 0;
	d->src_reset = 0;
}

static struct sf_stream *find_stream(struct sf_dedup *d, uint16_t src, uint8_t class_)
{
	unsigned int i;

	for (i = 0; i < SF_STREAM_CAP; i++) {
		if (d->item[i].used && d->item[i].src == src && d->item[i].class_ == class_) {
			return &d->item[i];
		}
	}
	return NULL;
}

static struct sf_stream *alloc_stream(struct sf_dedup *d, int64_t now, uint32_t idle_ms)
{
	unsigned int i;
	struct sf_stream *oldest = NULL;

	for (i = 0; i < SF_STREAM_CAP; i++) {
		if (!d->item[i].used) {
			return &d->item[i];
		}
		if (idle_ms > 0 && (now - d->item[i].last_ms) >= (int64_t)idle_ms) {
			d->item[i].used = false;
			d->evictions++;
			return &d->item[i];
		}
		if (oldest == NULL || d->item[i].last_ms < oldest->last_ms) {
			oldest = &d->item[i];
		}
	}
	if (oldest != NULL) {
		oldest->used = false;
		d->evictions++;
		return oldest;
	}
	return NULL;
}

void sf_dedup_check(struct sf_dedup *d, uint16_t src, uint8_t class_, uint16_t epoch,
		    uint16_t seq, int64_t now, uint32_t idle_ms, bool enabled,
		    struct sf_dedup_out *out)
{
	struct sf_stream *s;

	out->result = SF_DEDUP_NEW;
	out->gap = 0;
	out->src_reset = false;
	out->old_epoch = 0;
	out->new_epoch = epoch;
	if (!enabled) {
		return;
	}

	s = find_stream(d, src, class_);
	if (s == NULL) {
		return;
	}
	if (idle_ms > 0 && (now - s->last_ms) >= (int64_t)idle_ms) {
		s->used = false;
		d->evictions++;
		return;
	}

	if (epoch != s->epoch) {
		if (sf_delta16(epoch, s->epoch) > 0) {
			out->src_reset = true;
			out->old_epoch = s->epoch;
			out->new_epoch = epoch;
			out->result = SF_DEDUP_NEW;
			return;
		}
		out->result = SF_DEDUP_STALE_EPOCH;
		d->stale_epoch++;
		return;
	}

	{
		int16_t delta = sf_delta16(seq, s->last_seq);

		if (delta <= 0) {
			out->result = SF_DEDUP_DUP;
			d->dups++;
			s->last_ms = now;
			return;
		}
		if (delta > 1) {
			out->gap = (uint16_t)(delta - 1);
		}
		out->result = SF_DEDUP_NEW;
	}
}

void sf_dedup_commit(struct sf_dedup *d, uint16_t src, uint8_t class_, uint16_t epoch,
		     uint16_t seq, int64_t now)
{
	struct sf_stream *s = find_stream(d, src, class_);

	if (s == NULL) {
		s = alloc_stream(d, now, 0);
		if (s == NULL) {
			return;
		}
		s->src = src;
		s->class_ = class_;
	} else if (epoch == s->epoch) {
		int16_t delta = sf_delta16(seq, s->last_seq);

		if (delta > 1) {
			d->gaps += (uint32_t)(delta - 1);
		}
	}
	s->used = true;
	s->epoch = epoch;
	s->last_seq = seq;
	s->last_ms = now;
}

void sf_dedup_sweep(struct sf_dedup *d, int64_t now, uint32_t idle_ms)
{
	unsigned int i;

	if (idle_ms == 0) {
		return;
	}
	for (i = 0; i < SF_STREAM_CAP; i++) {
		if (d->item[i].used && (now - d->item[i].last_ms) >= (int64_t)idle_ms) {
			d->item[i].used = false;
			d->evictions++;
		}
	}
}
```

## src/sf_dedup.h
```c
/*
 * Copyright (c) 2026 Conexio Technologies, Inc
 *
 * SPDX-License-Identifier: Apache-2.0
 */

#ifndef SF_DEDUP_H_
#define SF_DEDUP_H_

#include "sf_types.h"

enum sf_dedup_result {
	SF_DEDUP_NEW = 0,
	SF_DEDUP_DUP = 1,
	SF_DEDUP_STALE_EPOCH = 2,
};

struct sf_stream {
	bool used;
	uint16_t src;
	uint8_t class_;
	uint16_t epoch;
	uint16_t last_seq;
	int64_t last_ms;
};

struct sf_dedup {
	struct sf_stream item[SF_STREAM_CAP];
	uint32_t evictions;
	uint32_t gaps;
	uint32_t stale_epoch;
	uint32_t dups;
	uint8_t src_reset;
	uint16_t src_reset_id;
	uint16_t src_reset_old;
	uint16_t src_reset_new;
};

struct sf_dedup_out {
	enum sf_dedup_result result;
	uint16_t gap;
	bool src_reset;
	uint16_t old_epoch;
	uint16_t new_epoch;
};

void sf_dedup_init(struct sf_dedup *d);
/* Commit is false for a lookup that must not move last_seq (store failure). */
void sf_dedup_check(struct sf_dedup *d, uint16_t src, uint8_t class_, uint16_t epoch,
		    uint16_t seq, int64_t now, uint32_t idle_ms, bool enabled,
		    struct sf_dedup_out *out);
void sf_dedup_commit(struct sf_dedup *d, uint16_t src, uint8_t class_, uint16_t epoch,
		     uint16_t seq, int64_t now);
void sf_dedup_sweep(struct sf_dedup *d, int64_t now, uint32_t idle_ms);

#endif /* SF_DEDUP_H_ */
```

## src/sf_link.c
```c
/*
 * Copyright (c) 2026 Conexio Technologies, Inc
 *
 * SPDX-License-Identifier: Apache-2.0
 */

#include "sf_link.h"

void sf_link_init(struct sf_link_table *t)
{
	unsigned int i;

	for (i = 0; i < SF_LINK_CAP; i++) {
		t->item[i].used = false;
	}
}

struct sf_link *sf_link_find(struct sf_link_table *t, uint16_t next_id)
{
	unsigned int i;

	for (i = 0; i < SF_LINK_CAP; i++) {
		if (t->item[i].used && t->item[i].next_id == next_id) {
			return &t->item[i];
		}
	}
	return NULL;
}

struct sf_link *sf_link_ensure(struct sf_link_table *t, uint16_t next_id, int64_t now,
			       bool assume_up)
{
	struct sf_link *l = sf_link_find(t, next_id);
	unsigned int i;

	if (next_id == 0 || next_id == SF_ID_BCAST) {
		return NULL;
	}
	if (l != NULL) {
		return l;
	}
	for (i = 0; i < SF_LINK_CAP; i++) {
		if (!t->item[i].used) {
			l = &t->item[i];
			break;
		}
	}
	if (l == NULL) {
		return NULL;
	}
	l->used = true;
	l->next_id = next_id;
	l->state = assume_up ? SF_LINK_UP : SF_LINK_DOWN;
	l->consec = 0;
	l->down_streak = 0;
	l->heard_hello = false;
	l->last_hello_ms = 0;
	l->hold_until_ms = now;
	l->up_since_ms = now;
	l->next_probe_ms = now;
	return l;
}

static uint32_t hold_ms(uint8_t streak, uint32_t min_ms, uint32_t max_ms)
{
	uint32_t h = min_ms;
	uint8_t i;

	if (streak < 1) {
		streak = 1;
	}
	for (i = 1; i < streak; i++) {
		if (max_ms > 0 && h > max_ms / 2u) {
			return max_ms;
		}
		h *= 2u;
	}
	if (max_ms > 0 && h > max_ms) {
		return max_ms;
	}
	return h;
}

static void change(struct sf_link *l, uint8_t next, const char *reason, sf_link_fn fn, void *ctx)
{
	uint8_t old = l->state;

	l->state = next;
	if (fn != NULL && old != next) {
		fn(ctx, l, old, reason);
	}
}

void sf_link_fail(struct sf_link *l, int64_t now, const char *reason, uint32_t hold_min_ms,
		  uint32_t hold_max_ms, uint32_t hold_reset_ms, uint32_t t_probe_ms,
		  sf_link_fn on_change, void *ctx)
{
	uint8_t streak;

	if (l == NULL) {
		return;
	}
	if (l->state == SF_LINK_UP && hold_reset_ms > 0 &&
	    (now - l->up_since_ms) >= (int64_t)hold_reset_ms) {
		streak = 1;
	} else {
		streak = (uint8_t)(l->down_streak + 1u);
		if (streak == 0) {
			streak = 255;
		}
	}
	l->down_streak = streak;
	l->consec = 0;
	l->hold_until_ms = now + (int64_t)hold_ms(streak, hold_min_ms, hold_max_ms);
	l->next_probe_ms = l->hold_until_ms + (int64_t)t_probe_ms;
	change(l, SF_LINK_DOWN, reason, on_change, ctx);
}

void sf_link_tick(struct sf_link_table *t, int64_t now, uint32_t hello_dead_ms, uint32_t t_probe_ms,
		  uint32_t hold_min_ms, uint32_t hold_max_ms, uint32_t hold_reset_ms,
		  sf_link_fn on_change, void *ctx)
{
	unsigned int i;

	for (i = 0; i < SF_LINK_CAP; i++) {
		struct sf_link *l = &t->item[i];

		if (!l->used) {
			continue;
		}
		if (l->state == SF_LINK_UP && hello_dead_ms > 0 && l->heard_hello &&
		    (now - l->last_hello_ms) > (int64_t)hello_dead_ms) {
			l->heard_hello = false;
			sf_link_fail(l, now, "hello_dead", hold_min_ms, hold_max_ms, hold_reset_ms,
				     t_probe_ms, on_change, ctx);
			continue;
		}
		if (l->state == SF_LINK_DOWN && now >= l->hold_until_ms) {
			bool timer = (t_probe_ms == 0) || (now >= l->next_probe_ms);

			if (l->heard_hello || timer) {
				l->consec = 0;
				l->next_probe_ms = now;
				change(l, SF_LINK_PROBING, l->heard_hello ? "hello" : "t_probe",
				       on_change, ctx);
			}
		}
	}
}

void sf_link_note_hello(struct sf_link *l, int64_t now)
{
	if (l == NULL) {
		return;
	}
	l->heard_hello = true;
	l->last_hello_ms = now;
}

void sf_link_probe_ok(struct sf_link *l, int64_t now, uint8_t n_up, uint32_t probe_fast_ms,
		      sf_link_fn on_change, void *ctx)
{
	if (l == NULL) {
		return;
	}
	if (n_up == 0) {
		n_up = 1;
	}
	l->consec++;
	l->next_probe_ms = now + (int64_t)probe_fast_ms;
	if (l->state == SF_LINK_PROBING && l->consec >= n_up) {
		l->up_since_ms = now;
		change(l, SF_LINK_UP, "probes", on_change, ctx);
	}
}

void sf_link_force_probe(struct sf_link *l, int64_t now, sf_link_fn on_change, void *ctx)
{
	if (l == NULL) {
		return;
	}
	l->consec = 0;
	l->hold_until_ms = now;
	l->next_probe_ms = now;
	l->heard_hello = true;
	l->last_hello_ms = now;
	if (l->state != SF_LINK_PROBING) {
		change(l, SF_LINK_PROBING, "neighbor_reset", on_change, ctx);
	}
}
```

## src/sf_link.h
```c
/*
 * Copyright (c) 2026 Conexio Technologies, Inc
 *
 * SPDX-License-Identifier: Apache-2.0
 */

#ifndef SF_LINK_H_
#define SF_LINK_H_

#include "sf_types.h"

struct sf_link {
	bool used;
	uint16_t next_id;
	uint8_t state;
	uint8_t consec;
	uint8_t down_streak;
	bool heard_hello;
	int64_t last_hello_ms;
	int64_t hold_until_ms;
	int64_t up_since_ms;
	int64_t next_probe_ms;
};

struct sf_link_table {
	struct sf_link item[SF_LINK_CAP];
};

typedef void (*sf_link_fn)(void *ctx, const struct sf_link *link, uint8_t old_state,
			   const char *reason);

void sf_link_init(struct sf_link_table *t);
struct sf_link *sf_link_find(struct sf_link_table *t, uint16_t next_id);
struct sf_link *sf_link_ensure(struct sf_link_table *t, uint16_t next_id, int64_t now,
			       bool assume_up);
void sf_link_tick(struct sf_link_table *t, int64_t now, uint32_t hello_dead_ms, uint32_t t_probe_ms,
		  uint32_t hold_min_ms, uint32_t hold_max_ms, uint32_t hold_reset_ms,
		  sf_link_fn on_change, void *ctx);
void sf_link_note_hello(struct sf_link *l, int64_t now);
void sf_link_probe_ok(struct sf_link *l, int64_t now, uint8_t n_up, uint32_t probe_fast_ms,
		      sf_link_fn on_change, void *ctx);
void sf_link_fail(struct sf_link *l, int64_t now, const char *reason, uint32_t hold_min_ms,
		  uint32_t hold_max_ms, uint32_t hold_reset_ms, uint32_t t_probe_ms,
		  sf_link_fn on_change, void *ctx);
void sf_link_force_probe(struct sf_link *l, int64_t now, sf_link_fn on_change, void *ctx);

#endif /* SF_LINK_H_ */
```

## src/sf_node.h
```c
/*
 * Copyright (c) 2026 Conexio Technologies, Inc
 *
 * SPDX-License-Identifier: Apache-2.0
 *
 * Protocol engine. No Zephyr calls: the radio thread and the host test both
 * drive poll / on_tx_done / on_rx. One DATA or PROBE frame is in flight.
 */

#ifndef SF_NODE_H_
#define SF_NODE_H_

#include "sf_link.h"
#include "sf_store.h"
#include "sf_dedup.h"

#include <stddef.h>

enum sf_act_kind {
	SF_ACT_RX = 0,
	SF_ACT_TX = 1,
};

struct sf_action {
	uint8_t kind;
	bool inflight; /* TX is the tracked DATA/PROBE, not an ACK or HELLO */
	bool want_ack;
	uint32_t rx_ms;
	uint16_t tx_len;
	uint8_t tx[SF_PAYLOAD_MAX];
};

typedef void (*sf_emit_fn)(void *ctx, const char *line);
typedef void (*sf_print_fn)(void *ctx, const char *line);
typedef uint32_t (*sf_rng_fn)(void);
typedef int64_t (*sf_us_fn)(void);

struct sf_node;

void sf_node_init(struct sf_node *n, const struct sf_cfg *cfg, const struct sf_route *routes,
		  unsigned int nroutes, uint16_t epoch, struct sf_store store);
void sf_node_set_emit(struct sf_node *n, sf_emit_fn fn, void *ctx);
void sf_node_set_rng(struct sf_node *n, sf_rng_fn fn);
void sf_node_set_clock(struct sf_node *n, sf_us_fn fn);

int sf_node_start(struct sf_node *n, int64_t now, uint32_t count_or_zero_for_cfg);
void sf_node_stop(struct sf_node *n, int64_t now, const char *reason);
bool sf_node_running(const struct sf_node *n);
uint16_t sf_node_epoch(const struct sf_node *n);
const struct sf_cfg *sf_node_cfg(const struct sf_node *n);
const struct sf_counters *sf_node_counters(const struct sf_node *n);
const struct sf_store *sf_node_store(const struct sf_node *n);

void sf_node_poll(struct sf_node *n, int64_t now, struct sf_action *act);
void sf_node_on_tx_done(struct sf_node *n, int64_t now, bool ok, bool was_inflight);
void sf_node_on_rx(struct sf_node *n, int64_t now, const uint8_t *data, uint16_t len,
		   int16_t rssi_x2);

int sf_node_alarm(struct sf_node *n, int64_t now);
uint16_t sf_node_flush(struct sf_node *n, int64_t now, const char *reason);

int sf_node_set(struct sf_node *n, const char *key, const char *value, char *err, size_t err_len);
int sf_node_route_set(struct sf_node *n, uint16_t dst, uint16_t next, char *err, size_t err_len);
int sf_node_route_del(struct sf_node *n, uint16_t dst);
void sf_node_route_clear(struct sf_node *n);
void sf_node_apply_cfg(struct sf_node *n, const struct sf_cfg *cfg);

void sf_node_dump_cfg(const struct sf_node *n, sf_print_fn fn, void *ctx);
void sf_node_status(const struct sf_node *n, int64_t now, sf_print_fn fn, void *ctx);
void sf_node_report_sf(const struct sf_node *n, sf_print_fn fn, void *ctx);
void sf_node_report_link(const struct sf_node *n, sf_print_fn fn, void *ctx);
void sf_node_report_neigh(const struct sf_node *n, sf_print_fn fn, void *ctx);
void sf_node_report_route(const struct sf_node *n, sf_print_fn fn, void *ctx);

unsigned int sf_node_route_export(const struct sf_node *n, struct sf_route *out, unsigned int cap);

/* Opaque size: the test and the port allocate sf_node by this header's struct.
 * The full struct is in the header so the firmware can put it in BSS.
 */
struct sf_ack_slot {
	uint16_t len;
	uint8_t buf[32];
};

struct sf_inflight {
	bool active;
	bool from_store;
	bool waiting_backoff;
	uint8_t type;
	uint8_t attempts;
	uint8_t class_;
	uint16_t next_id;
	uint16_t src;
	uint16_t seq;
	uint16_t epoch;
	uint32_t order;
	int64_t deadline_ms;
	int64_t backoff_until_ms;
	int64_t tx_done_ms;
	uint16_t len;
	uint8_t buf[SF_PAYLOAD_MAX];
};

struct sf_neigh {
	bool used;
	bool have_epoch;
	uint16_t id;
	uint16_t epoch;
	int16_t rssi_x2;
	int64_t last_ms;
	uint32_t heard;
};

struct sf_node {
	struct sf_cfg cfg;
	struct sf_store store;
	struct sf_dedup dedup;
	struct sf_link_table links;
	struct sf_route route[SF_ROUTE_CAP];
	struct sf_neigh neigh[SF_NEIGH_CAP];
	struct sf_counters ct;
	struct sf_inflight inf;
	struct sf_ack_slot ackq[SF_ACKQ_CAP];
	uint8_t ack_n;
	uint32_t ack_dropped;
	uint16_t seq_next[2];
	uint16_t epoch;
	uint32_t probe_nonce;
	uint32_t run_count;
	uint32_t alarm_tokens_m;
	int64_t alarm_ts_ms;
	int64_t last_gen_ms;
	int64_t next_hello_ms;
	int64_t gap_until_ms;
	int64_t holdoff_ms[2];
	bool running;
	char line[240];
	sf_emit_fn emit;
	void *emit_ctx;
	sf_rng_fn rng;
	sf_us_fn clock_us;
};

#endif /* SF_NODE_H_ */
```

## src/sf_persist.h
```c
/*
 * Copyright (c) 2026 Conexio Technologies, Inc
 *
 * SPDX-License-Identifier: Apache-2.0
 */

#ifndef SF_PERSIST_H_
#define SF_PERSIST_H_

#include "sf_types.h"

#include <stdbool.h>
#include <stdint.h>

struct sf_persist_view {
	struct sf_cfg cfg;
	struct sf_route route[SF_ROUTE_CAP];
	unsigned int nroutes;
	bool autostart;
	bool present;
};

int sf_persist_init(void);
bool sf_persist_load(struct sf_persist_view *out);
int sf_persist_save(const struct sf_cfg *cfg, const struct sf_route *routes, unsigned int nroutes,
		    bool autostart);
int sf_persist_clear(void);
bool sf_persist_present(void);

uint16_t sf_persist_boot_epoch(uint32_t *delay_ms);
void sf_persist_mark_stable(void);

bool sf_persist_autostart(void);
void sf_persist_autostart_set(bool on);

#endif /* SF_PERSIST_H_ */
```

## src/sf_port.h
```c
/*
 * Copyright (c) 2026 Conexio Technologies, Inc
 *
 * SPDX-License-Identifier: Apache-2.0
 */

#ifndef SF_PORT_H_
#define SF_PORT_H_

#include "sf_node.h"

#include <stdbool.h>
#include <stdint.h>

void sf_port_boot(uint16_t node_id);
uint16_t sf_port_node_id(void);
bool sf_port_autostart_ok(void);

int sf_port_start(uint32_t count_or_zero);
void sf_port_stop(const char *reason);
bool sf_port_running(void);
void sf_port_wait_until_started(void);

void sf_port_poll(struct sf_action *act);
void sf_port_on_tx_done(bool ok, bool was_inflight);
void sf_port_on_pdc(const uint8_t *data, uint16_t len, int16_t rssi_x2);
void sf_port_drain_rx(void);
void sf_port_radio(uint8_t *power, uint8_t *mcs);
void sf_port_note_stable_if_due(void);

int sf_port_set(const char *key, const char *value, char *err, size_t err_len);
int sf_port_route_set(uint16_t dst, uint16_t next, char *err, size_t err_len);
int sf_port_route_del(uint16_t dst);
int sf_port_alarm(void);
uint16_t sf_port_flush(const char *reason);
int sf_port_save(void);
int sf_port_load(char *err, size_t err_len);
int sf_port_factory(char *err, size_t err_len);
void sf_port_autostart_set(bool on);
bool sf_port_autostart_get(void);
bool sf_port_profile_present(void);

void sf_port_print_status(sf_print_fn fn, void *ctx);
void sf_port_print_cfg(sf_print_fn fn, void *ctx);
void sf_port_print_sf(sf_print_fn fn, void *ctx);
void sf_port_print_link(sf_print_fn fn, void *ctx);
void sf_port_print_neigh(sf_print_fn fn, void *ctx);
void sf_port_print_route(sf_print_fn fn, void *ctx);

#endif /* SF_PORT_H_ */
```
