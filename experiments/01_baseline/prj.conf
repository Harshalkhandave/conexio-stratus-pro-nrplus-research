## CMakeLists.txt
```
#
# Copyright (c) 2024 Nordic Semiconductor
# Copyright (c) 2026 Conexio Technologies, Inc
#
# SPDX-License-Identifier: LicenseRef-Nordic-5-Clause
#

cmake_minimum_required(VERSION 3.20.0)

find_package(Zephyr REQUIRED HINTS $ENV{ZEPHYR_BASE})
project(nrplus_exp_baseline)

target_sources(app PRIVATE
  src/main.c
  src/exp_runtime.c
)

target_include_directories(app PRIVATE src)

if(CONFIG_EXPERIMENT_SHELL)
  target_sources(app PRIVATE src/exp_shell.c)
endif()
```

## Kconfig
```
#
# Copyright (c) 2024 Nordic Semiconductor
# Copyright (c) 2026 Conexio Technologies, Inc
#
# SPDX-License-Identifier: LicenseRef-Nordic-5-Clause
#

config CARRIER
	int "Carrier to use"
	default 0
	help
	   The availability of the channels and the exact regulation to use them varies in different countries.
	   See ETSI TS 103 636-2 5.4.2 for the calculation.
	   Band index 1 is set when the carrier is within the range of 525 to 551.
	   This is the only range allowed for band index 1 as other carriers will interfere with other radio devices, including LTE devices.

config NETWORK_ID
	int "Network ID"
	range 1 4294967295
	default 91

config MCS
	int "MCS"
	default 0
	help
	   The MCS impacts how much data can fit into each subslot.

config TX_POWER
	int "TX power"
	range 0 13
	default 13
	help
	   Transmission power, max 19 dBm due to hardware limitations.
	   See table 6.2.1-3 of ETSI TS 103 636-4 v1.5.1.

config TX_TRANSMISSIONS
	int "TX transmissions"
	range 0 4294967295
	default 0
	help
	   Number of TX packets before the application exits.
	   Use 0 to transmit forever (tx_rx / tx_only modes).

config RX_PERIOD_S
	int "RX period"
	default 5
	help
	   Receive window period in seconds (tx_rx and rx_only modes).

config TX_INTERVAL_MS
	int "Extra interval between iterations (ms)"
	default 500
	help
	   Sleep after each TX (tx_only) or after each TX+RX cycle (tx_rx).
	   Ignored in rx_only mode.

choice EXPERIMENT_TEST_MODE
	prompt "Experiment test mode"
	default EXPERIMENT_TEST_MODE_TX_RX
	help
	   Role of this board in the experiment.

config EXPERIMENT_TEST_MODE_TX_RX
	bool "TX then RX (default)"
	help
	   Transmit one packet, then listen for CONFIG_RX_PERIOD_S seconds.

config EXPERIMENT_TEST_MODE_TX_ONLY
	bool "TX only"
	help
	   Transmit only; pace with CONFIG_TX_INTERVAL_MS.

config EXPERIMENT_TEST_MODE_RX_ONLY
	bool "RX only"
	help
	   Receive only; repeated RX windows of CONFIG_RX_PERIOD_S.

endchoice

config EXPERIMENT_PACKET_SIZE
	int "On-air packet size (bytes)"
	range 15 32
	default 15
	help
	   Total PDC payload size. Must be >= sizeof(experiment_packet) (15).
	   Extra bytes are zero-padded after the header.

config EXPERIMENT_MESSAGE_TYPE
	int "Payload message_type field"
	range 0 255
	default 1
	help
	   Application message type written into each packet (1 = baseline).

config EXPERIMENT_DEST_RECEIVER_ID
	int "RX filter destination identity"
	range 0 65535
	default 0
	help
	   PHY RX filter receiver_identity. 0 = broadcast / accept all (v1.0).
	   Non-zero reserved for future unicast filtering.

config EXPERIMENT_DEVICE_ID_OVERRIDE
	bool "Override hardware device ID"
	default n
	help
	   When enabled, use CONFIG_EXPERIMENT_DEVICE_ID instead of hwinfo.

config EXPERIMENT_DEVICE_ID
	int "Device ID override value"
	depends on EXPERIMENT_DEVICE_ID_OVERRIDE
	range 1 65535
	default 1

config EXPERIMENT_LOG_COMPACT
	bool "Compact experiment logging (TX:/RX: only)"
	default y
	help
	   Emit machine-parseable TX: and RX: lines at INF.
	   Extra human-readable bring-up logs stay at DBG.

config EXPERIMENT_SHELL
	bool "Enable exp shell commands on UART"
	default y
	select SHELL
	select SHELL_BACKEND_SERIAL
	help
	   Adds exp status|sett|start|stop. Auto-start still runs unless
	   EXPERIMENT_WAIT_FOR_START is enabled.

config EXPERIMENT_WAIT_FOR_START
	bool "Do not auto-start; wait for 'exp start'"
	default n
	depends on EXPERIMENT_SHELL
	help
	   When disabled (default), the radio loop starts after boot.
	   When enabled, the board stays idle until: exp start

module = DECT_PHY_HELLO
module-str = DECT NR+ PHY Hello
source "$(ZEPHYR_BASE)/subsys/logging/Kconfig.template.log_config"

menu "Zephyr Kernel"
source "Kconfig.zephyr"
endmenu
```

## sample.yaml
```
sample:
  name: NR+ Experimental Firmware v1.0 (01_baseline)
tests:
  sample.dect_phy.dect_hello.eu.sysbuild:
    sysbuild: true
    build_only: true
    integration_platforms:
      - nrf9151dk/nrf9151/ns
      - nrf9161dk/nrf9161/ns
    platform_allow:
      - nrf9151dk/nrf9151/ns
      - nrf9161dk/nrf9161/ns
    extra_args: EXTRA_CONF_FILE="overlay-eu.conf"
    tags:
      - ci_build
      - sysbuild
      - ci_samples_dect
  sample.dect_phy.dect_hello.us.sysbuild:
    sysbuild: true
    build_only: true
    integration_platforms:
      - nrf9151dk/nrf9151/ns
      - nrf9161dk/nrf9161/ns
    platform_allow:
      - nrf9151dk/nrf9151/ns
      - nrf9161dk/nrf9161/ns
    extra_args: EXTRA_CONF_FILE="overlay-us.conf"
    tags:
      - ci_build
      - sysbuild
      - ci_samples_dect
```

## prj.conf
```kconfig
CONFIG_NRF_MODEM_LIB=y

CONFIG_MODEM_ANTENNA=n

CONFIG_NRF_MODEM_LINK_BINARY_DECT_PHY=y
CONFIG_HWINFO=y

CONFIG_LOG=y

# Enable Zephyr application to be booted by MCUboot
CONFIG_BOOTLOADER_MCUBOOT=y

# Experiment shell (exp status|sett|start|stop); auto-start remains on by default
CONFIG_EXPERIMENT_SHELL=y
CONFIG_SHELL_STACK_SIZE=2048
CONFIG_SHELL_CMD_BUFF_SIZE=256
```

## overlay-1000pkts.conf
```kconfig
# Finite run: 1000 packets then exit (use with tx_rx or tx_only)
CONFIG_TX_TRANSMISSIONS=1000
```

## overlay-rx-only.conf
```kconfig
# RX-only role for range / PDR sink / listener node
CONFIG_EXPERIMENT_TEST_MODE_RX_ONLY=y
```

## overlay-tx-only.conf
```kconfig
# TX-only role for range / PDR source node
CONFIG_EXPERIMENT_TEST_MODE_TX_ONLY=y
```

## overlay-wait-start.conf
```kconfig
# Idle until "exp start" (formal range campaigns)
CONFIG_EXPERIMENT_WAIT_FOR_START=y
```

## src/main.c
```c
/*
 * Copyright (c) 2024 Nordic Semiconductor ASA
 * Copyright (c) 2026 Conexio Technologies, Inc
 *
 * SPDX-License-Identifier: LicenseRef-Nordic-5-Clause
 *
 * NR+ Experimental Firmware — DECT NR+ PHY baseline (+ optional exp shell).
 */
#include <inttypes.h>
#include <limits.h>
#include <string.h>
#include <zephyr/kernel.h>
#include <zephyr/logging/log.h>
#include <zephyr/sys/util.h>
#include <nrf_modem_dect_phy.h>
#include <modem/nrf_modem_lib.h>
#include <zephyr/drivers/hwinfo.h>

#include "experiment_packet.h"
#include "exp_runtime.h"

LOG_MODULE_REGISTER(app);

BUILD_ASSERT(CONFIG_CARRIER, "Carrier must be configured according to local regulations");
BUILD_ASSERT(CONFIG_EXPERIMENT_PACKET_SIZE >= sizeof(struct experiment_packet),
	     "CONFIG_EXPERIMENT_PACKET_SIZE too small for experiment_packet");
BUILD_ASSERT(sizeof(struct experiment_packet) == 15,
	     "experiment_packet size changed — update docs");

#define DATA_LEN_MAX 32
#define RADIO_STACK_SIZE 4096

static bool phy_fatal;
static uint64_t modem_time;
static uint16_t last_sender_id;

#define SEQ_TRACK_MAX 4
struct seq_track {
	uint16_t id;
	uint32_t seq;
	bool used;
};
static struct seq_track seq_tracks[SEQ_TRACK_MAX];

static void note_rx_sequence(uint16_t from_id, uint32_t sequence)
{
	struct seq_track *slot = NULL;
	struct exp_runtime *rt = exp_runtime_get();

	for (int i = 0; i < SEQ_TRACK_MAX; i++) {
		if (seq_tracks[i].used && seq_tracks[i].id == from_id) {
			slot = &seq_tracks[i];
			break;
		}
		if (!seq_tracks[i].used && slot == NULL) {
			slot = &seq_tracks[i];
		}
	}

	if (slot == NULL) {
		return;
	}

	if (slot->used && sequence != slot->seq + 1U && sequence != 0U) {
		LOG_WRN("RX gap: from=%u prev_seq=%u seq=%u", from_id, slot->seq, sequence);
		exp_runtime_lock();
		rt->rx_gaps++;
		exp_runtime_unlock();
	}

	slot->used = true;
	slot->id = from_id;
	slot->seq = sequence;
}

struct phy_ctrl_field_common {
	uint32_t packet_length : 4;
	uint32_t packet_length_type : 1;
	uint32_t header_format : 3;
	uint32_t short_network_id : 8;
	uint32_t transmitter_id_hi : 8;
	uint32_t transmitter_id_lo : 8;
	uint32_t df_mcs : 3;
	uint32_t reserved : 1;
	uint32_t transmit_power : 4;
	uint32_t pad : 24;
};

K_SEM_DEFINE(operation_sem, 0, 1);
K_SEM_DEFINE(deinit_sem, 0, 1);

static void on_init(const struct nrf_modem_dect_phy_init_event *evt)
{
	if (evt->err) {
		LOG_ERR("Init failed, err %d", evt->err);
		phy_fatal = true;
		return;
	}
	k_sem_give(&operation_sem);
}

static void on_deinit(const struct nrf_modem_dect_phy_deinit_event *evt)
{
	if (evt->err) {
		LOG_ERR("Deinit failed, err %d", evt->err);
		return;
	}
	k_sem_give(&deinit_sem);
}

static void on_activate(const struct nrf_modem_dect_phy_activate_event *evt)
{
	if (evt->err) {
		LOG_ERR("Activate failed, err %d", evt->err);
		phy_fatal = true;
		return;
	}
	k_sem_give(&operation_sem);
}

static void on_deactivate(const struct nrf_modem_dect_phy_deactivate_event *evt)
{
	if (evt->err) {
		LOG_ERR("Deactivate failed, err %d", evt->err);
		return;
	}
	k_sem_give(&deinit_sem);
}

static void on_configure(const struct nrf_modem_dect_phy_configure_event *evt)
{
	if (evt->err) {
		LOG_ERR("Configure failed, err %d", evt->err);
		return;
	}
	k_sem_give(&operation_sem);
}

static void on_link_config(const struct nrf_modem_dect_phy_link_config_event *evt)
{
	LOG_DBG("link_config cb time %" PRIu64 " status %d", modem_time, evt->err);
}

static void on_radio_config(const struct nrf_modem_dect_phy_radio_config_event *evt)
{
	if (evt->err) {
		LOG_ERR("Radio config failed, err %d", evt->err);
		return;
	}
	k_sem_give(&operation_sem);
}

static void on_capability_get(const struct nrf_modem_dect_phy_capability_get_event *evt)
{
	LOG_DBG("capability_get cb time %" PRIu64 " status %d", modem_time, evt->err);
}

static void on_bands_get(const struct nrf_modem_dect_phy_band_get_event *evt)
{
	LOG_DBG("bands_get cb status %d", evt->err);
}

static void on_latency_info_get(const struct nrf_modem_dect_phy_latency_info_event *evt)
{
	LOG_DBG("latency_info_get cb status %d", evt->err);
}

static void on_time_get(const struct nrf_modem_dect_phy_time_get_event *evt)
{
	LOG_DBG("time_get cb time %" PRIu64 " status %d", modem_time, evt->err);
}

static void on_cancel(const struct nrf_modem_dect_phy_cancel_event *evt)
{
	LOG_DBG("on_cancel cb status %d", evt->err);
	k_sem_give(&operation_sem);
}

static void on_op_complete(const struct nrf_modem_dect_phy_op_complete_event *evt)
{
	LOG_DBG("op_complete cb time %" PRIu64 " status %d", modem_time, evt->err);
	k_sem_give(&operation_sem);
}

static void on_pcc(const struct nrf_modem_dect_phy_pcc_event *evt)
{
	last_sender_id = (evt->hdr.hdr_type_1.transmitter_id_hi << 8) |
			 evt->hdr.hdr_type_1.transmitter_id_lo;
	LOG_DBG("PCC from device ID %u", last_sender_id);
}

static void on_pcc_crc_err(const struct nrf_modem_dect_phy_pcc_crc_failure_event *evt)
{
	ARG_UNUSED(evt);
	LOG_DBG("pcc_crc_err cb time %" PRIu64, modem_time);
}

static void on_pdc(const struct nrf_modem_dect_phy_pdc_event *evt)
{
	uint64_t rx_time_ms = k_uptime_get();
	int rssi_i = evt->rssi_2 / 2;
	int rssi_f = (evt->rssi_2 & 1) * 5;
	struct exp_runtime *rt = exp_runtime_get();

	if (evt->len < sizeof(struct experiment_packet)) {
		LOG_WRN("RX: node=%u seq= short size=%u from=%u rssi=%d.%d time=%llu cs=fail",
			exp_device_id(), evt->len, last_sender_id, rssi_i, rssi_f,
			(unsigned long long)rx_time_ms);
		exp_runtime_lock();
		rt->rx_fail++;
		exp_runtime_unlock();
		return;
	}

	const struct experiment_packet *pkt = (const struct experiment_packet *)evt->data;
	bool cs_ok = experiment_packet_verify(pkt);
	uint16_t from_id = last_sender_id;

	if (cs_ok && pkt->device_id != 0) {
		from_id = pkt->device_id;
	}

	LOG_INF("RX: node=%u seq=%u from=%u rssi=%d.%d time=%llu tx_time=%u size=%u type=%u cs=%s",
		exp_device_id(), pkt->sequence, from_id, rssi_i, rssi_f,
		(unsigned long long)rx_time_ms, pkt->tx_time_ms, evt->len, pkt->message_type,
		cs_ok ? "ok" : "fail");

	exp_runtime_lock();
	if (cs_ok) {
		rt->rx_ok++;
		rt->last_from = from_id;
		if (evt->rssi_2 < rt->rssi_min_x2) {
			rt->rssi_min_x2 = evt->rssi_2;
		}
		if (evt->rssi_2 > rt->rssi_max_x2) {
			rt->rssi_max_x2 = evt->rssi_2;
		}
		rt->rssi_sum_x2 += evt->rssi_2;
		rt->rssi_n++;
	} else {
		rt->rx_fail++;
	}
	exp_runtime_unlock();

	if (cs_ok) {
		note_rx_sequence(from_id, pkt->sequence);
	}
}

static void on_pdc_crc_err(const struct nrf_modem_dect_phy_pdc_crc_failure_event *evt)
{
	ARG_UNUSED(evt);
	LOG_DBG("pdc_crc_err cb time %" PRIu64, modem_time);
}

static void on_rssi(const struct nrf_modem_dect_phy_rssi_event *evt)
{
	LOG_DBG("rssi cb time %" PRIu64 " carrier %d", modem_time, evt->carrier);
}

static void on_stf_cover_seq_control(const struct nrf_modem_dect_phy_stf_control_event *evt)
{
	ARG_UNUSED(evt);
	LOG_WRN("Unexpectedly in %s", __func__);
}

static void on_test_rf_tx_cw_ctrl(const struct nrf_modem_dect_phy_test_rf_tx_cw_control_event *evt)
{
	ARG_UNUSED(evt);
	LOG_WRN("Unexpectedly in %s", __func__);
}

static void dect_phy_event_handler(const struct nrf_modem_dect_phy_event *evt)
{
	modem_time = evt->time;

	switch (evt->id) {
	case NRF_MODEM_DECT_PHY_EVT_INIT:
		on_init(&evt->init);
		break;
	case NRF_MODEM_DECT_PHY_EVT_DEINIT:
		on_deinit(&evt->deinit);
		break;
	case NRF_MODEM_DECT_PHY_EVT_ACTIVATE:
		on_activate(&evt->activate);
		break;
	case NRF_MODEM_DECT_PHY_EVT_DEACTIVATE:
		on_deactivate(&evt->deactivate);
		break;
	case NRF_MODEM_DECT_PHY_EVT_CONFIGURE:
		on_configure(&evt->configure);
		break;
	case NRF_MODEM_DECT_PHY_EVT_RADIO_CONFIG:
		on_radio_config(&evt->radio_config);
		break;
	case NRF_MODEM_DECT_PHY_EVT_COMPLETED:
		on_op_complete(&evt->op_complete);
		break;
	case NRF_MODEM_DECT_PHY_EVT_CANCELED:
		on_cancel(&evt->cancel);
		break;
	case NRF_MODEM_DECT_PHY_EVT_RSSI:
		on_rssi(&evt->rssi);
		break;
	case NRF_MODEM_DECT_PHY_EVT_PCC:
		on_pcc(&evt->pcc);
		break;
	case NRF_MODEM_DECT_PHY_EVT_PCC_ERROR:
		on_pcc_crc_err(&evt->pcc_crc_err);
		break;
	case NRF_MODEM_DECT_PHY_EVT_PDC:
		on_pdc(&evt->pdc);
		break;
	case NRF_MODEM_DECT_PHY_EVT_PDC_ERROR:
		on_pdc_crc_err(&evt->pdc_crc_err);
		break;
	case NRF_MODEM_DECT_PHY_EVT_TIME:
		on_time_get(&evt->time_get);
		break;
	case NRF_MODEM_DECT_PHY_EVT_CAPABILITY:
		on_capability_get(&evt->capability_get);
		break;
	case NRF_MODEM_DECT_PHY_EVT_BANDS:
		on_bands_get(&evt->band_get);
		break;
	case NRF_MODEM_DECT_PHY_EVT_LATENCY:
		on_latency_info_get(&evt->latency_get);
		break;
	case NRF_MODEM_DECT_PHY_EVT_LINK_CONFIG:
		on_link_config(&evt->link_config);
		break;
	case NRF_MODEM_DECT_PHY_EVT_STF_CONFIG:
		on_stf_cover_seq_control(&evt->stf_cover_seq_control);
		break;
	case NRF_MODEM_DECT_PHY_EVT_TEST_RF_TX_CW_CONTROL_CONFIG:
		on_test_rf_tx_cw_ctrl(&evt->test_rf_tx_cw_control);
		break;
	}
}

static struct nrf_modem_dect_phy_config_params dect_phy_config_params = {
	.band_group_index = ((CONFIG_CARRIER >= 525 && CONFIG_CARRIER <= 551)) ? 1 : 0,
	.harq_rx_process_count = 4,
	.harq_rx_expiry_time_us = 5000000,
};

static int transmit(uint32_t handle, void *data, size_t data_len, uint8_t tx_power, uint8_t mcs)
{
	struct phy_ctrl_field_common header = {
		.header_format = 0x0,
		.packet_length_type = 0x0,
		.packet_length = 0x03,
		.short_network_id = (CONFIG_NETWORK_ID & 0xff),
		.transmitter_id_hi = (exp_device_id() >> 8),
		.transmitter_id_lo = (exp_device_id() & 0xff),
		.transmit_power = tx_power,
		.reserved = 0,
		.df_mcs = mcs,
	};

	struct nrf_modem_dect_phy_tx_params tx_op_params = {
		.start_time = 0,
		.handle = handle,
		.network_id = CONFIG_NETWORK_ID,
		.phy_type = 0,
		.lbt_rssi_threshold_max = 0,
		.carrier = CONFIG_CARRIER,
		.lbt_period = NRF_MODEM_DECT_LBT_PERIOD_MAX,
		.phy_header = (union nrf_modem_dect_phy_hdr *)&header,
		.data = data,
		.data_size = data_len,
	};

	return nrf_modem_dect_phy_tx(&tx_op_params);
}

static int receive(uint32_t handle)
{
	struct nrf_modem_dect_phy_rx_params rx_op_params = {
		.start_time = 0,
		.handle = handle,
		.network_id = CONFIG_NETWORK_ID,
		.mode = NRF_MODEM_DECT_PHY_RX_MODE_CONTINUOUS,
		.rssi_interval = NRF_MODEM_DECT_PHY_RSSI_INTERVAL_OFF,
		.link_id = NRF_MODEM_DECT_PHY_LINK_UNSPECIFIED,
		.rssi_level = -60,
		.carrier = CONFIG_CARRIER,
		.duration = CONFIG_RX_PERIOD_S * MSEC_PER_SEC *
			    NRF_MODEM_DECT_MODEM_TIME_TICK_RATE_KHZ,
		.filter.short_network_id = CONFIG_NETWORK_ID & 0xff,
		.filter.is_short_network_id_used = 1,
		.filter.receiver_identity = CONFIG_EXPERIMENT_DEST_RECEIVER_ID,
	};

	return nrf_modem_dect_phy_rx(&rx_op_params);
}

static void resolve_device_id(void)
{
	uint16_t id;

#if IS_ENABLED(CONFIG_EXPERIMENT_DEVICE_ID_OVERRIDE)
	id = (uint16_t)CONFIG_EXPERIMENT_DEVICE_ID;
#else
	hwinfo_get_device_id((void *)&id, sizeof(id));
#endif
	exp_set_device_id(id);
}

static int send_one(uint32_t tx_handle, uint8_t *tx_buf)
{
	int err;
	struct exp_runtime *rt = exp_runtime_get();
	uint32_t sequence;
	uint16_t tx_len;
	uint8_t tx_power;
	uint8_t mcs;
	uint8_t msg_type;
	struct experiment_packet *pkt = (struct experiment_packet *)tx_buf;

	exp_runtime_lock();
	sequence = rt->sequence;
	tx_len = rt->packet_size;
	tx_power = rt->tx_power;
	mcs = rt->mcs;
	msg_type = rt->message_type;
	exp_runtime_unlock();

	if (tx_len < sizeof(*pkt) || tx_len > DATA_LEN_MAX) {
		LOG_ERR("invalid packet size %u", tx_len);
		return -EINVAL;
	}

	memset(tx_buf, 0, DATA_LEN_MAX);
	pkt->device_id = exp_device_id();
	pkt->message_type = msg_type;
	pkt->flags = 0;
	pkt->sequence = sequence;
	pkt->tx_time_ms = (uint32_t)k_uptime_get();
	pkt->payload_len = (uint16_t)(tx_len - sizeof(*pkt));
	experiment_packet_finalize(pkt);

	LOG_INF("TX: node=%u seq=%u size=%u time=%u type=%u", exp_device_id(), pkt->sequence,
		tx_len, pkt->tx_time_ms, pkt->message_type);

	err = transmit(tx_handle, tx_buf, tx_len, tx_power, mcs);
	if (err) {
		LOG_ERR("Transmission failed, err %d", err);
		return err;
	}
	return 0;
}

static void clear_seq_tracks(void)
{
	memset(seq_tracks, 0, sizeof(seq_tracks));
}

static void radio_thread_fn(void *p1, void *p2, void *p3)
{
	ARG_UNUSED(p1);
	ARG_UNUSED(p2);
	ARG_UNUSED(p3);

	uint32_t tx_handle = 0;
	uint32_t rx_handle = 1;
	uint8_t tx_buf[DATA_LEN_MAX];
	struct exp_runtime *rt = exp_runtime_get();

	while (1) {
		exp_wait_until_start();
		clear_seq_tracks();
		LOG_INF("run active");

		while (exp_is_running()) {
			int err;

			if (IS_ENABLED(CONFIG_EXPERIMENT_TEST_MODE_RX_ONLY)) {
				err = receive(rx_handle);
				if (err) {
					LOG_ERR("Reception failed, err %d", err);
					exp_request_stop();
					exp_print_summary("rx_error");
					break;
				}
				k_sem_take(&operation_sem, K_FOREVER);
				continue;
			}

			err = send_one(tx_handle, tx_buf);
			if (err) {
				exp_request_stop();
				exp_print_summary("tx_error");
				break;
			}

			k_sem_take(&operation_sem, K_FOREVER);

			exp_runtime_lock();
			rt->sequence++;
			rt->tx_sent++;
			uint32_t sent = rt->tx_sent;
			uint32_t count = rt->tx_count;
			uint32_t interval = rt->tx_interval_ms;
			exp_runtime_unlock();

			if (count && sent >= count) {
				exp_request_stop();
				exp_print_summary("count_reached");
				LOG_INF("Reached transmission count (%u)", count);
				break;
			}

			if (!exp_is_running()) {
				exp_print_summary("stop");
				break;
			}

			if (IS_ENABLED(CONFIG_EXPERIMENT_TEST_MODE_TX_RX)) {
				err = receive(rx_handle);
				if (err) {
					LOG_ERR("Reception failed, err %d", err);
					exp_request_stop();
					exp_print_summary("rx_error");
					break;
				}
				k_sem_take(&operation_sem, K_FOREVER);
			}

			if (!exp_is_running()) {
				exp_print_summary("stop");
				break;
			}

			if (interval > 0) {
				k_sleep(K_MSEC(interval));
			}
		}
	}
}

static K_THREAD_STACK_DEFINE(radio_stack, RADIO_STACK_SIZE);
static struct k_thread radio_thread_data;

int main(void)
{
	int err;

	exp_runtime_init();

	LOG_INF("NR+ Experimental Firmware v1.1 (01_baseline)");
	LOG_INF("mode=%s carrier=%d net=0x%x shell=%d wait_for_start=%d", exp_mode_str(),
		CONFIG_CARRIER, CONFIG_NETWORK_ID, IS_ENABLED(CONFIG_EXPERIMENT_SHELL),
		IS_ENABLED(CONFIG_EXPERIMENT_WAIT_FOR_START));

	err = nrf_modem_lib_init();
	if (err) {
		LOG_ERR("modem init failed, err %d", err);
		return err;
	}

	err = nrf_modem_dect_phy_event_handler_set(dect_phy_event_handler);
	if (err) {
		LOG_ERR("nrf_modem_dect_phy_event_handler_set failed, err %d", err);
		return err;
	}

	err = nrf_modem_dect_phy_init();
	if (err) {
		LOG_ERR("nrf_modem_dect_phy_init failed, err %d", err);
		return err;
	}

	k_sem_take(&operation_sem, K_FOREVER);
	if (phy_fatal) {
		return -EIO;
	}

	err = nrf_modem_dect_phy_configure(&dect_phy_config_params);
	if (err) {
		LOG_ERR("nrf_modem_dect_phy_configure failed, err %d", err);
		return err;
	}

	k_sem_take(&operation_sem, K_FOREVER);
	if (phy_fatal) {
		return -EIO;
	}

	err = nrf_modem_dect_phy_activate(NRF_MODEM_DECT_PHY_RADIO_MODE_LOW_LATENCY);
	if (err) {
		LOG_ERR("nrf_modem_dect_phy_activate failed, err %d", err);
		return err;
	}

	k_sem_take(&operation_sem, K_FOREVER);
	if (phy_fatal) {
		return -EIO;
	}

	resolve_device_id();
	LOG_INF("device_id=%u (0x%04x)", exp_device_id(), exp_device_id());
	LOG_INF("Commands: exp status | exp sett | exp start [count] | exp stop");

	err = nrf_modem_dect_phy_capability_get();
	if (err) {
		LOG_ERR("nrf_modem_dect_phy_capability_get failed, err %d", err);
	}

	k_thread_create(&radio_thread_data, radio_stack, RADIO_STACK_SIZE, radio_thread_fn, NULL,
			NULL, NULL, 5, 0, K_NO_WAIT);
	k_thread_name_set(&radio_thread_data, "exp_radio");

	if (!IS_ENABLED(CONFIG_EXPERIMENT_WAIT_FOR_START)) {
		exp_request_start(UINT32_MAX);
		LOG_INF("auto-start enabled");
	} else {
		LOG_INF("waiting for: exp start");
	}

	/* Shell (if enabled) runs on UART; radio thread does the work. */
	return 0;
}
```

## src/exp_runtime.c
```c
/*
 * Copyright (c) 2026 Conexio Technologies, Inc
 *
 * SPDX-License-Identifier: Apache-2.0
 */

#include "exp_runtime.h"

#include <limits.h>
#include <zephyr/kernel.h>
#include <zephyr/sys/printk.h>
#include <zephyr/sys/util.h>

static struct exp_runtime rt;
static uint16_t g_device_id;
static struct k_mutex rt_lock;
static struct k_sem start_sem;

static void reset_stats_locked(void)
{
	rt.sequence = 0;
	rt.tx_sent = 0;
	rt.rx_ok = 0;
	rt.rx_fail = 0;
	rt.rx_gaps = 0;
	rt.last_from = 0;
	rt.rssi_min_x2 = INT32_MAX;
	rt.rssi_max_x2 = INT32_MIN;
	rt.rssi_sum_x2 = 0;
	rt.rssi_n = 0;
}

void exp_runtime_init(void)
{
	k_mutex_init(&rt_lock);
	k_sem_init(&start_sem, 0, 1);

	rt.running = false;
	rt.tx_interval_ms = CONFIG_TX_INTERVAL_MS;
	rt.tx_count = CONFIG_TX_TRANSMISSIONS;
	rt.tx_power = (uint8_t)CONFIG_TX_POWER;
	rt.mcs = (uint8_t)CONFIG_MCS;
	rt.packet_size = (uint16_t)CONFIG_EXPERIMENT_PACKET_SIZE;
	rt.message_type = (uint8_t)CONFIG_EXPERIMENT_MESSAGE_TYPE;
	reset_stats_locked();
}

struct exp_runtime *exp_runtime_get(void)
{
	return &rt;
}

void exp_runtime_lock(void)
{
	k_mutex_lock(&rt_lock, K_FOREVER);
}

void exp_runtime_unlock(void)
{
	k_mutex_unlock(&rt_lock);
}

void exp_set_device_id(uint16_t id)
{
	g_device_id = id;
}

uint16_t exp_device_id(void)
{
	return g_device_id;
}

const char *exp_mode_str(void)
{
	if (IS_ENABLED(CONFIG_EXPERIMENT_TEST_MODE_TX_ONLY)) {
		return "tx_only";
	}
	if (IS_ENABLED(CONFIG_EXPERIMENT_TEST_MODE_RX_ONLY)) {
		return "rx_only";
	}
	return "tx_rx";
}

void exp_runtime_reset_stats(void)
{
	k_mutex_lock(&rt_lock, K_FOREVER);
	reset_stats_locked();
	k_mutex_unlock(&rt_lock);
}

void exp_request_start(uint32_t count_override)
{
	k_mutex_lock(&rt_lock, K_FOREVER);
	if (count_override != UINT32_MAX) {
		rt.tx_count = count_override;
	}
	reset_stats_locked();
	rt.running = true;
	k_mutex_unlock(&rt_lock);
	k_sem_give(&start_sem);
}

void exp_request_stop(void)
{
	k_mutex_lock(&rt_lock, K_FOREVER);
	rt.running = false;
	k_mutex_unlock(&rt_lock);
	k_sem_give(&start_sem);
}

bool exp_is_running(void)
{
	bool r;

	k_mutex_lock(&rt_lock, K_FOREVER);
	r = rt.running;
	k_mutex_unlock(&rt_lock);
	return r;
}

void exp_wait_until_start(void)
{
	while (!exp_is_running()) {
		k_sem_take(&start_sem, K_FOREVER);
	}
}

void exp_print_status(void)
{
	struct exp_runtime snap;

	k_mutex_lock(&rt_lock, K_FOREVER);
	snap = rt;
	k_mutex_unlock(&rt_lock);

	printk("exp status:\n");
	printk("  mode=%s running=%d device_id=%u\n", exp_mode_str(), snap.running, g_device_id);
	printk("  carrier=%d net=0x%x\n", CONFIG_CARRIER, CONFIG_NETWORK_ID);
	printk("  interval_ms=%u count=%u (0=forever)\n", snap.tx_interval_ms, snap.tx_count);
	printk("  power=%u mcs=%u size=%u type=%u\n", snap.tx_power, snap.mcs, snap.packet_size,
	       snap.message_type);
	printk("  seq_next=%u tx_sent=%u rx_ok=%u rx_fail=%u gaps=%u\n", snap.sequence, snap.tx_sent,
	       snap.rx_ok, snap.rx_fail, snap.rx_gaps);
}

void exp_print_summary(const char *reason)
{
	struct exp_runtime snap;
	int avg_i = 0;
	int avg_f = 0;
	int min_i = 0;
	int min_f = 0;
	int max_i = 0;
	int max_f = 0;

	k_mutex_lock(&rt_lock, K_FOREVER);
	snap = rt;
	k_mutex_unlock(&rt_lock);

	if (snap.rssi_n > 0) {
		int32_t avg_x2 = (int32_t)(snap.rssi_sum_x2 / (int64_t)snap.rssi_n);

		avg_i = avg_x2 / 2;
		avg_f = (avg_x2 & 1) * 5;
		min_i = snap.rssi_min_x2 / 2;
		min_f = (snap.rssi_min_x2 & 1) * 5;
		max_i = snap.rssi_max_x2 / 2;
		max_f = (snap.rssi_max_x2 & 1) * 5;
	}

	if (IS_ENABLED(CONFIG_EXPERIMENT_TEST_MODE_RX_ONLY)) {
		printk("SUMMARY: role=rx reason=%s device_id=%u from=%u ok=%u fail=%u gaps=%u "
		       "rssi_min=%d.%d rssi_avg=%d.%d rssi_max=%d.%d\n",
		       reason, g_device_id, snap.last_from, snap.rx_ok, snap.rx_fail, snap.rx_gaps,
		       min_i, min_f, avg_i, avg_f, max_i, max_f);
	} else if (IS_ENABLED(CONFIG_EXPERIMENT_TEST_MODE_TX_ONLY)) {
		printk("SUMMARY: role=tx reason=%s device_id=%u sent=%u count_cfg=%u\n", reason,
		       g_device_id, snap.tx_sent, snap.tx_count);
	} else {
		printk("SUMMARY: role=tx_rx reason=%s device_id=%u sent=%u rx_ok=%u rx_fail=%u "
		       "gaps=%u\n",
		       reason, g_device_id, snap.tx_sent, snap.rx_ok, snap.rx_fail, snap.rx_gaps);
	}
}
```

## src/exp_runtime.h
```c
/*
 * Copyright (c) 2026 Conexio Technologies, Inc
 *
 * SPDX-License-Identifier: Apache-2.0
 */

#ifndef EXP_RUNTIME_H_
#define EXP_RUNTIME_H_

#include <stdbool.h>
#include <stdint.h>

struct exp_runtime {
	bool running;
	uint32_t tx_interval_ms;
	uint32_t tx_count; /* 0 = forever */
	uint8_t tx_power;
	uint8_t mcs;
	uint16_t packet_size;
	uint8_t message_type;

	uint32_t sequence;
	uint32_t tx_sent;
	uint32_t rx_ok;
	uint32_t rx_fail;
	uint32_t rx_gaps;
	uint16_t last_from;
	int32_t rssi_min_x2;
	int32_t rssi_max_x2;
	int64_t rssi_sum_x2;
	uint32_t rssi_n;
};

void exp_runtime_init(void);
struct exp_runtime *exp_runtime_get(void);
void exp_runtime_lock(void);
void exp_runtime_unlock(void);

void exp_runtime_reset_stats(void);

/** count_override: UINT32_MAX = keep current count setting */
void exp_request_start(uint32_t count_override);
void exp_request_stop(void);
bool exp_is_running(void);
void exp_wait_until_start(void);

void exp_print_status(void);
void exp_print_summary(const char *reason);

const char *exp_mode_str(void);
uint16_t exp_device_id(void);
void exp_set_device_id(uint16_t id);

#endif /* EXP_RUNTIME_H_ */
```

## src/exp_shell.c
```c
/*
 * Copyright (c) 2026 Conexio Technologies, Inc
 *
 * SPDX-License-Identifier: Apache-2.0
 */

#include "exp_runtime.h"

#include <stdlib.h>
#include <string.h>
#include <zephyr/kernel.h>
#include <zephyr/shell/shell.h>

static int cmd_status(const struct shell *sh, size_t argc, char **argv)
{
	ARG_UNUSED(sh);
	ARG_UNUSED(argc);
	ARG_UNUSED(argv);
	exp_print_status();
	return 0;
}

static int cmd_start(const struct shell *sh, size_t argc, char **argv)
{
	uint32_t count = UINT32_MAX;
	uint32_t configured;

	if (argc >= 2) {
		count = (uint32_t)strtoul(argv[1], NULL, 0);
	}

	if (exp_is_running()) {
		shell_print(sh, "already running; stop first");
		return -EALREADY;
	}

	exp_request_start(count);
	exp_runtime_lock();
	configured = exp_runtime_get()->tx_count;
	exp_runtime_unlock();
	shell_print(sh, "started (count=%u, 0=forever)", configured);
	return 0;
}

static int cmd_stop(const struct shell *sh, size_t argc, char **argv)
{
	ARG_UNUSED(argc);
	ARG_UNUSED(argv);

	if (!exp_is_running()) {
		shell_print(sh, "not running");
		return 0;
	}

	exp_request_stop();
	shell_print(sh, "stop requested");
	return 0;
}

static int cmd_sett(const struct shell *sh, size_t argc, char **argv)
{
	struct exp_runtime *rt;
	unsigned long v;

	if (argc < 3) {
		shell_print(sh, "usage: exp sett <interval|count|power|mcs|size|type> <value>");
		return -EINVAL;
	}

	if (exp_is_running()) {
		shell_print(sh, "stop the run before changing settings");
		return -EBUSY;
	}

	v = strtoul(argv[2], NULL, 0);
	rt = exp_runtime_get();
	exp_runtime_lock();

	if (strcmp(argv[1], "interval") == 0) {
		rt->tx_interval_ms = (uint32_t)v;
	} else if (strcmp(argv[1], "count") == 0) {
		rt->tx_count = (uint32_t)v;
	} else if (strcmp(argv[1], "power") == 0) {
		if (v > 13) {
			exp_runtime_unlock();
			shell_print(sh, "power must be 0..13");
			return -EINVAL;
		}
		rt->tx_power = (uint8_t)v;
	} else if (strcmp(argv[1], "mcs") == 0) {
		if (v > 7) {
			exp_runtime_unlock();
			shell_print(sh, "mcs must be 0..7");
			return -EINVAL;
		}
		rt->mcs = (uint8_t)v;
	} else if (strcmp(argv[1], "size") == 0) {
		if (v < 15 || v > 32) {
			exp_runtime_unlock();
			shell_print(sh, "size must be 15..32");
			return -EINVAL;
		}
		rt->packet_size = (uint16_t)v;
	} else if (strcmp(argv[1], "type") == 0) {
		if (v > 255) {
			exp_runtime_unlock();
			shell_print(sh, "type must be 0..255");
			return -EINVAL;
		}
		rt->message_type = (uint8_t)v;
	} else {
		exp_runtime_unlock();
		shell_print(sh, "unknown key '%s'", argv[1]);
		return -EINVAL;
	}

	exp_runtime_unlock();
	shell_print(sh, "ok");
	return 0;
}

SHELL_STATIC_SUBCMD_SET_CREATE(sub_exp,
			       SHELL_CMD(status, NULL, "Show experiment status", cmd_status),
			       SHELL_CMD_ARG(start, NULL, "Start run [count]", cmd_start, 1, 1),
			       SHELL_CMD(stop, NULL, "Stop run and print SUMMARY", cmd_stop),
			       SHELL_CMD_ARG(sett, NULL, "Set interval|count|power|mcs|size|type",
					     cmd_sett, 3, 0),
			       SHELL_SUBCMD_SET_END);

SHELL_CMD_REGISTER(exp, &sub_exp, "NR+ experiment control", NULL);
```

## src/experiment_packet.h
```c
/*
 * Copyright (c) 2026 Conexio Technologies, Inc
 *
 * SPDX-License-Identifier: Apache-2.0
 *
 * NR+ Experimental Firmware v1.0 — on-air packet format.
 */

#ifndef EXPERIMENT_PACKET_H_
#define EXPERIMENT_PACKET_H_

#include <stdbool.h>
#include <stddef.h>
#include <stdint.h>

/** Message type: baseline experiment probe. */
#define EXPERIMENT_MSG_TYPE_BASELINE 1

/**
 * Packed application PDU carried in the DECT PHY PDC.
 *
 * Clocks: tx_time_ms is sender k_uptime_get() — not synchronized across nodes.
 * Checksum: XOR of all bytes before the checksum field.
 */
struct experiment_packet {
	uint16_t device_id;
	uint8_t message_type;
	uint8_t flags;
	uint32_t sequence;
	uint32_t tx_time_ms;
	uint16_t payload_len; /* trailing pad bytes after this header (usually 0) */
	uint8_t checksum;
} __attribute__((packed));

/* Expected sizeof(struct experiment_packet) == 15 */

static inline uint8_t experiment_checksum(const void *data, size_t len)
{
	const uint8_t *b = data;
	uint8_t cs = 0;

	for (size_t i = 0; i < len; i++) {
		cs ^= b[i];
	}
	return cs;
}

static inline void experiment_packet_finalize(struct experiment_packet *pkt)
{
	pkt->checksum = 0;
	pkt->checksum = experiment_checksum(pkt, sizeof(*pkt) - 1);
}

static inline bool experiment_packet_verify(const struct experiment_packet *pkt)
{
	uint8_t expect = experiment_checksum(pkt, sizeof(*pkt) - 1);

	return pkt->checksum == expect;
}

#endif /* EXPERIMENT_PACKET_H_ */
```
