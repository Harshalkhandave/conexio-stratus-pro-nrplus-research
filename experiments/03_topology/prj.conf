## CMakeLists.txt
```
#
# Copyright (c) 2024 Nordic Semiconductor
# Copyright (c) 2026 Conexio Technologies, Inc
#
# SPDX-License-Identifier: LicenseRef-Nordic-5-Clause
#

cmake_minimum_required(VERSION 3.20.0)

find_package(Zephyr REQUIRED HINTS $ENV{ZEPHYR_BASE})
project(nrplus_exp_topology)

target_sources(app PRIVATE
  src/main.c
  src/topo_runtime.c
)

target_include_directories(app PRIVATE src)

if(CONFIG_TOPO_SHELL)
  target_sources(app PRIVATE src/topo_shell.c)
endif()

if(CONFIG_TOPO_PERSIST)
  target_sources(app PRIVATE src/topo_persist.c)
endif()
```

## Kconfig
```
#
# Copyright (c) 2024 Nordic Semiconductor
# Copyright (c) 2026 Conexio Technologies, Inc
#
# SPDX-License-Identifier: LicenseRef-Nordic-5-Clause
#

config CARRIER
	int "Carrier to use"
	default 0
	help
	   The availability of the channels and the exact regulation to use them varies in different countries.
	   See ETSI TS 103 636-2 5.4.2 for the calculation.
	   Band index 1 is set when the carrier is within the range of 525 to 551.
	   This is the only range allowed for band index 1 as other carriers will interfere with other radio devices, including LTE devices.

config NETWORK_ID
	int "Network ID"
	range 1 4294967295
	default 91

config MCS
	int "MCS"
	default 0
	help
	   The MCS impacts how much data can fit into each subslot.

config TX_POWER
	int "TX power"
	range 0 13
	default 13
	help
	   Transmission power, max 19 dBm due to hardware limitations.
	   See table 6.2.1-3 of ETSI TS 103 636-4 v1.5.1.

config TX_TRANSMISSIONS
	int "TX transmissions (source DATA count)"
	range 0 4294967295
	default 0
	help
	   Number of DATA packets a source sends before stopping.
	   Use 0 for forever. Ignored for relay/sink roles.

config RX_PERIOD_S
	int "RX period"
	default 2
	help
	   Receive window period in seconds between TX / forward work.

config TX_INTERVAL_MS
	int "Extra interval between source DATA iterations (ms)"
	default 500

config HELLO_INTERVAL_MS
	int "HELLO advertisement interval (ms)"
	default 2000
	help
	   0 disables periodic HELLO. Applies to all roles while running.

choice TOPO_DEFAULT_ROLE
	prompt "Default topology role (overridable via shell)"
	default TOPO_ROLE_SOURCE

config TOPO_ROLE_SOURCE
	bool "Source (originate DATA)"

config TOPO_ROLE_RELAY
	bool "Relay (forward DATA toward dst)"

config TOPO_ROLE_SINK
	bool "Sink (accept DATA when dst matches)"

endchoice

config TOPO_DEST_ID
	int "Default DATA destination device ID (source)"
	range 0 65535
	default 0
	help
	   Source sets packet dst to this ID. 0 means unset — set via shell before start.

config TOPO_MAX_HOPS
	int "Max hop_count before drop (relay)"
	range 1 16
	default 3

config TOPO_DEDUP
	bool "Relay duplicate detection (drop re-seen src+seq pairs)"
	default y
	help
	  When enabled the relay keeps a small table of recently forwarded
	  (source, sequence) pairs and silently drops packets it has already
	  forwarded.  Disable for reboot / healing experiments where the
	  source sequence counter resets to 0 on every boot.

config TOPO_PACKET_SIZE
	int "On-air packet size (bytes)"
	range 18 128
	default 18
	help
	   Total PDC payload size. Must be >= sizeof(topo_packet) (18).
	   Extra bytes are zero-padded after the header.

config TOPO_DEST_RECEIVER_ID
	int "PHY RX filter destination identity"
	range 0 65535
	default 0
	help
	   PHY RX filter receiver_identity. 0 = broadcast / accept all.

config TOPO_DEVICE_ID_OVERRIDE
	bool "Override hardware device ID"
	default n

config TOPO_DEVICE_ID
	int "Device ID override value"
	depends on TOPO_DEVICE_ID_OVERRIDE
	range 1 65535
	default 1

config TOPO_SHELL
	bool "Enable exp shell commands on UART"
	default y
	select SHELL
	select SHELL_BACKEND_SERIAL
	help
	   Adds exp status|role|sett|start|stop|neigh for topology lab control.

config TOPO_WAIT_FOR_START
	bool "Do not auto-start; wait for 'exp start' (unless NVS autostart)"
	default y
	depends on TOPO_SHELL
	help
	   Default on for topology so roles/RF can be set before the run.
	   If a flash profile was saved with autostart=on, the board still
	   auto-starts after reset even when this option is enabled.

config TOPO_PERSIST
	bool "Persist role/RF/autostart in flash (exp save)"
	default y
	depends on TOPO_SHELL
	select SETTINGS
	select NVS
	select FLASH
	select FLASH_MAP
	help
	   Enables exp save|load|factory|autostart so settings survive reset
	   (Week 4 reboot / power-fail tests). The NVS settings backend must
	   be chosen in prj.conf (CONFIG_SETTINGS_NVS=y); it is a choice
	   symbol and cannot be selected from here.

module = DECT_PHY_TOPO
module-str = DECT NR+ PHY Topology
source "$(ZEPHYR_BASE)/subsys/logging/Kconfig.template.log_config"

menu "Zephyr Kernel"
source "Kconfig.zephyr"
endmenu
```

## sample.yaml
```
sample:
  name: NR+ Topology Firmware (03_topology)
tests:
  sample.dect_phy.topo.eu.sysbuild:
    sysbuild: true
    build_only: true
    integration_platforms:
      - nrf9151dk/nrf9151/ns
      - nrf9161dk/nrf9161/ns
    platform_allow:
      - nrf9151dk/nrf9151/ns
      - nrf9161dk/nrf9161/ns
    extra_args: EXTRA_CONF_FILE="overlay-eu.conf"
    tags:
      - ci_build
      - sysbuild
      - ci_samples_dect
  sample.dect_phy.topo.us.sysbuild:
    sysbuild: true
    build_only: true
    integration_platforms:
      - nrf9151dk/nrf9151/ns
      - nrf9161dk/nrf9161/ns
    platform_allow:
      - nrf9151dk/nrf9151/ns
      - nrf9161dk/nrf9161/ns
    extra_args: EXTRA_CONF_FILE="overlay-us.conf"
    tags:
      - ci_build
      - sysbuild
      - ci_samples_dect
```

## prj.conf
```kconfig
CONFIG_NRF_MODEM_LIB=y

CONFIG_MODEM_ANTENNA=n

CONFIG_NRF_MODEM_LINK_BINARY_DECT_PHY=y
CONFIG_HWINFO=y

CONFIG_LOG=y
CONFIG_LOG_BUFFER_SIZE=32768
CONFIG_LOG_PROCESS_TRIGGER_THRESHOLD=2

# Enable Zephyr application to be booted by MCUboot
CONFIG_BOOTLOADER_MCUBOOT=y

# Topology shell (roles + RF); idle until "exp start" unless NVS autostart
CONFIG_TOPO_SHELL=y
CONFIG_TOPO_WAIT_FOR_START=y
CONFIG_TOPO_PERSIST=y
CONFIG_SHELL_STACK_SIZE=2048
CONFIG_SHELL_CMD_BUFF_SIZE=256

# Flash settings (NVS) for exp save / autostart across reset
CONFIG_FLASH=y
CONFIG_FLASH_MAP=y
CONFIG_FLASH_PAGE_LAYOUT=y
CONFIG_MPU_ALLOW_FLASH_WRITE=y
CONFIG_NVS=y
CONFIG_SETTINGS=y
CONFIG_SETTINGS_NVS=y
CONFIG_PM_PARTITION_SIZE_SETTINGS_STORAGE=0x4000
```

## src/main.c
```c
/*
 * Copyright (c) 2024 Nordic Semiconductor ASA
 * Copyright (c) 2026 Conexio Technologies, Inc
 *
 * SPDX-License-Identifier: LicenseRef-Nordic-5-Clause
 *
 * NR+ Experimental Firmware — three-node topology (app-layer relay on PHY).
 */
#include <inttypes.h>
#include <limits.h>
#include <string.h>
#include <zephyr/kernel.h>
#include <zephyr/logging/log.h>
#include <zephyr/sys/util.h>
#include <nrf_modem_dect_phy.h>
#include <modem/nrf_modem_lib.h>
#include <zephyr/drivers/hwinfo.h>

#include "topo_packet.h"
#include "topo_persist.h"
#include "topo_runtime.h"

LOG_MODULE_REGISTER(app);

BUILD_ASSERT(CONFIG_CARRIER, "Carrier must be configured according to local regulations");
BUILD_ASSERT(CONFIG_TOPO_PACKET_SIZE >= sizeof(struct topo_packet),
	     "CONFIG_TOPO_PACKET_SIZE too small for topo_packet");
BUILD_ASSERT(sizeof(struct topo_packet) == 18, "topo_packet size changed — update docs");

#define DATA_LEN_MAX 128
#define RADIO_STACK_SIZE 4096

static bool phy_fatal;
static uint64_t modem_time;
static uint16_t last_sender_id;
static int64_t last_hello_ms;

struct phy_ctrl_field_common {
	uint32_t packet_length : 4;
	uint32_t packet_length_type : 1;
	uint32_t header_format : 3;
	uint32_t short_network_id : 8;
	uint32_t transmitter_id_hi : 8;
	uint32_t transmitter_id_lo : 8;
	uint32_t df_mcs : 3;
	uint32_t reserved : 1;
	uint32_t transmit_power : 4;
	uint32_t pad : 24;
};

K_SEM_DEFINE(operation_sem, 0, 1);
K_SEM_DEFINE(deinit_sem, 0, 1);

static void on_init(const struct nrf_modem_dect_phy_init_event *evt)
{
	if (evt->err) {
		LOG_ERR("Init failed, err %d", evt->err);
		phy_fatal = true;
		return;
	}
	k_sem_give(&operation_sem);
}

static void on_deinit(const struct nrf_modem_dect_phy_deinit_event *evt)
{
	if (evt->err) {
		LOG_ERR("Deinit failed, err %d", evt->err);
		return;
	}
	k_sem_give(&deinit_sem);
}

static void on_activate(const struct nrf_modem_dect_phy_activate_event *evt)
{
	if (evt->err) {
		LOG_ERR("Activate failed, err %d", evt->err);
		phy_fatal = true;
		return;
	}
	k_sem_give(&operation_sem);
}

static void on_deactivate(const struct nrf_modem_dect_phy_deactivate_event *evt)
{
	if (evt->err) {
		LOG_ERR("Deactivate failed, err %d", evt->err);
		return;
	}
	k_sem_give(&deinit_sem);
}

static void on_configure(const struct nrf_modem_dect_phy_configure_event *evt)
{
	if (evt->err) {
		LOG_ERR("Configure failed, err %d", evt->err);
		return;
	}
	k_sem_give(&operation_sem);
}

static void on_link_config(const struct nrf_modem_dect_phy_link_config_event *evt)
{
	LOG_DBG("link_config cb time %" PRIu64 " status %d", modem_time, evt->err);
}

static void on_radio_config(const struct nrf_modem_dect_phy_radio_config_event *evt)
{
	if (evt->err) {
		LOG_ERR("Radio config failed, err %d", evt->err);
		return;
	}
	k_sem_give(&operation_sem);
}

static void on_capability_get(const struct nrf_modem_dect_phy_capability_get_event *evt)
{
	LOG_DBG("capability_get cb time %" PRIu64 " status %d", modem_time, evt->err);
}

static void on_bands_get(const struct nrf_modem_dect_phy_band_get_event *evt)
{
	LOG_DBG("bands_get cb status %d", evt->err);
}

static void on_latency_info_get(const struct nrf_modem_dect_phy_latency_info_event *evt)
{
	LOG_DBG("latency_info_get cb status %d", evt->err);
}

static void on_time_get(const struct nrf_modem_dect_phy_time_get_event *evt)
{
	LOG_DBG("time_get cb time %" PRIu64 " status %d", modem_time, evt->err);
}

static void on_cancel(const struct nrf_modem_dect_phy_cancel_event *evt)
{
	LOG_DBG("on_cancel cb status %d", evt->err);
	k_sem_give(&operation_sem);
}

static void on_op_complete(const struct nrf_modem_dect_phy_op_complete_event *evt)
{
	LOG_DBG("op_complete cb time %" PRIu64 " status %d", modem_time, evt->err);
	k_sem_give(&operation_sem);
}

static void on_pcc(const struct nrf_modem_dect_phy_pcc_event *evt)
{
	last_sender_id = (evt->hdr.hdr_type_1.transmitter_id_hi << 8) |
			 evt->hdr.hdr_type_1.transmitter_id_lo;
	LOG_DBG("PCC from device ID %u", last_sender_id);
}

static void on_pcc_crc_err(const struct nrf_modem_dect_phy_pcc_crc_failure_event *evt)
{
	ARG_UNUSED(evt);
	LOG_DBG("pcc_crc_err cb time %" PRIu64, modem_time);
}

static void handle_data_rx(const struct topo_packet *pkt, int rssi_i, int rssi_f, uint64_t rx_time_ms)
{
	struct topo_runtime *rt = topo_runtime_get();
	enum topo_role role;
	uint8_t max_hops;
	uint16_t me = topo_device_id();

	topo_runtime_lock();
	role = rt->role;
	max_hops = rt->max_hops;
	topo_runtime_unlock();

	uint64_t rx_time_us = (uint64_t)k_ticks_to_us_near64(k_uptime_ticks());

	LOG_INF("RX: node=%u type=DATA seq=%u src=%u dst=%u prev=%u hop=%u rssi=%d.%d time=%llu time_us=%llu",
		me, pkt->sequence, pkt->src, pkt->dst, pkt->prev_hop, pkt->hop_count, rssi_i,
		rssi_f, (unsigned long long)rx_time_ms, (unsigned long long)rx_time_us);

	if (pkt->dst == me) {
		LOG_INF("DELIVER: node=%u seq=%u src=%u prev=%u hops=%u rssi=%d.%d time=%llu time_us=%llu", me,
			pkt->sequence, pkt->src, pkt->prev_hop, pkt->hop_count, rssi_i, rssi_f,
			(unsigned long long)rx_time_ms, (unsigned long long)rx_time_us);
		topo_runtime_lock();
		rt->deliver_ok++;
		topo_runtime_unlock();
		return;
	}

	/* Relays forward; source/sink do not rebroadcast DATA (avoids loops / floods). */
	if (role != TOPO_ROLE_RELAY_V) {
		return;
	}

	if (pkt->src == me) {
		return;
	}

	if (topo_seen_is_dup(pkt->src, pkt->sequence)) {
		LOG_DBG("drop dup src=%u seq=%u", pkt->src, pkt->sequence);
		return;
	}

	if (pkt->hop_count >= max_hops) {
		topo_runtime_lock();
		rt->fwd_drop_ttl++;
		topo_runtime_unlock();
		LOG_INF("FORWARD_DROP: node=%u seq=%u src=%u reason=ttl hop=%u max=%u", me,
			pkt->sequence, pkt->src, pkt->hop_count, max_hops);
		return;
	}

	{
		struct topo_packet fwd = *pkt;

		fwd.prev_hop = me;
		fwd.hop_count = (uint8_t)(pkt->hop_count + 1U);
		fwd.tx_time_ms = (uint32_t)k_uptime_get();
		topo_packet_finalize(&fwd);

		if (topo_fwd_enqueue(&fwd)) {
			LOG_INF("FORWARD_Q: node=%u seq=%u src=%u dst=%u prev=%u hop=%u", me,
				fwd.sequence, fwd.src, fwd.dst, fwd.prev_hop, fwd.hop_count);
		} else {
			LOG_WRN("FORWARD_DROP: node=%u seq=%u reason=queue_full", me, pkt->sequence);
		}
	}
}

static void on_pdc(const struct nrf_modem_dect_phy_pdc_event *evt)
{
	uint64_t rx_time_ms = k_uptime_get();
	int rssi_i = evt->rssi_2 / 2;
	int rssi_f = (evt->rssi_2 & 1) * 5;
	struct topo_runtime *rt = topo_runtime_get();

	if (evt->len < sizeof(struct topo_packet)) {
		LOG_WRN("RX: node=%u short size=%u from=%u rssi=%d.%d time=%llu cs=fail",
			topo_device_id(), evt->len, last_sender_id, rssi_i, rssi_f,
			(unsigned long long)rx_time_ms);
		topo_runtime_lock();
		rt->rx_fail++;
		topo_runtime_unlock();
		return;
	}

	const struct topo_packet *pkt = (const struct topo_packet *)evt->data;
	bool cs_ok = topo_packet_verify(pkt);
	uint16_t from_id = last_sender_id;

	if (cs_ok && pkt->prev_hop != 0) {
		from_id = pkt->prev_hop;
	} else if (cs_ok && pkt->src != 0) {
		from_id = pkt->src;
	}

	if (!cs_ok) {
		LOG_INF("RX: node=%u seq=%u from=%u rssi=%d.%d time=%llu size=%u cs=fail",
			topo_device_id(), pkt->sequence, from_id, rssi_i, rssi_f,
			(unsigned long long)rx_time_ms, evt->len);
		topo_runtime_lock();
		rt->rx_fail++;
		topo_runtime_unlock();
		return;
	}

	topo_runtime_lock();
	rt->rx_ok++;
	rt->last_from = from_id;
	if (evt->rssi_2 < rt->rssi_min_x2) {
		rt->rssi_min_x2 = evt->rssi_2;
	}
	if (evt->rssi_2 > rt->rssi_max_x2) {
		rt->rssi_max_x2 = evt->rssi_2;
	}
	rt->rssi_sum_x2 += evt->rssi_2;
	rt->rssi_n++;
	topo_runtime_unlock();

	topo_neigh_note(from_id, evt->rssi_2, pkt->message_type);

	if (pkt->message_type == TOPO_MSG_HELLO) {
		LOG_INF("RX: node=%u type=HELLO src=%u rssi=%d.%d time=%llu", topo_device_id(),
			pkt->src, rssi_i, rssi_f, (unsigned long long)rx_time_ms);
		return;
	}

	if (pkt->message_type == TOPO_MSG_DATA) {
		handle_data_rx(pkt, rssi_i, rssi_f, rx_time_ms);
		return;
	}

	LOG_INF("RX: node=%u type=%u seq=%u src=%u dst=%u rssi=%d.%d time=%llu", topo_device_id(),
		pkt->message_type, pkt->sequence, pkt->src, pkt->dst, rssi_i, rssi_f,
		(unsigned long long)rx_time_ms);
}

static void on_pdc_crc_err(const struct nrf_modem_dect_phy_pdc_crc_failure_event *evt)
{
	ARG_UNUSED(evt);
	LOG_DBG("pdc_crc_err cb time %" PRIu64, modem_time);
}

static void on_rssi(const struct nrf_modem_dect_phy_rssi_event *evt)
{
	LOG_DBG("rssi cb time %" PRIu64 " carrier %d", modem_time, evt->carrier);
}

static void on_stf_cover_seq_control(const struct nrf_modem_dect_phy_stf_control_event *evt)
{
	ARG_UNUSED(evt);
	LOG_WRN("Unexpectedly in %s", __func__);
}

static void on_test_rf_tx_cw_ctrl(const struct nrf_modem_dect_phy_test_rf_tx_cw_control_event *evt)
{
	ARG_UNUSED(evt);
	LOG_WRN("Unexpectedly in %s", __func__);
}

static void dect_phy_event_handler(const struct nrf_modem_dect_phy_event *evt)
{
	modem_time = evt->time;

	switch (evt->id) {
	case NRF_MODEM_DECT_PHY_EVT_INIT:
		on_init(&evt->init);
		break;
	case NRF_MODEM_DECT_PHY_EVT_DEINIT:
		on_deinit(&evt->deinit);
		break;
	case NRF_MODEM_DECT_PHY_EVT_ACTIVATE:
		on_activate(&evt->activate);
		break;
	case NRF_MODEM_DECT_PHY_EVT_DEACTIVATE:
		on_deactivate(&evt->deactivate);
		break;
	case NRF_MODEM_DECT_PHY_EVT_CONFIGURE:
		on_configure(&evt->configure);
		break;
	case NRF_MODEM_DECT_PHY_EVT_RADIO_CONFIG:
		on_radio_config(&evt->radio_config);
		break;
	case NRF_MODEM_DECT_PHY_EVT_COMPLETED:
		on_op_complete(&evt->op_complete);
		break;
	case NRF_MODEM_DECT_PHY_EVT_CANCELED:
		on_cancel(&evt->cancel);
		break;
	case NRF_MODEM_DECT_PHY_EVT_RSSI:
		on_rssi(&evt->rssi);
		break;
	case NRF_MODEM_DECT_PHY_EVT_PCC:
		on_pcc(&evt->pcc);
		break;
	case NRF_MODEM_DECT_PHY_EVT_PCC_ERROR:
		on_pcc_crc_err(&evt->pcc_crc_err);
		break;
	case NRF_MODEM_DECT_PHY_EVT_PDC:
		on_pdc(&evt->pdc);
		break;
	case NRF_MODEM_DECT_PHY_EVT_PDC_ERROR:
		on_pdc_crc_err(&evt->pdc_crc_err);
		break;
	case NRF_MODEM_DECT_PHY_EVT_TIME:
		on_time_get(&evt->time_get);
		break;
	case NRF_MODEM_DECT_PHY_EVT_CAPABILITY:
		on_capability_get(&evt->capability_get);
		break;
	case NRF_MODEM_DECT_PHY_EVT_BANDS:
		on_bands_get(&evt->band_get);
		break;
	case NRF_MODEM_DECT_PHY_EVT_LATENCY:
		on_latency_info_get(&evt->latency_get);
		break;
	case NRF_MODEM_DECT_PHY_EVT_LINK_CONFIG:
		on_link_config(&evt->link_config);
		break;
	case NRF_MODEM_DECT_PHY_EVT_STF_CONFIG:
		on_stf_cover_seq_control(&evt->stf_cover_seq_control);
		break;
	case NRF_MODEM_DECT_PHY_EVT_TEST_RF_TX_CW_CONTROL_CONFIG:
		on_test_rf_tx_cw_ctrl(&evt->test_rf_tx_cw_control);
		break;
	}
}

static struct nrf_modem_dect_phy_config_params dect_phy_config_params = {
	.band_group_index = ((CONFIG_CARRIER >= 525 && CONFIG_CARRIER <= 551)) ? 1 : 0,
	.harq_rx_process_count = 4,
	.harq_rx_expiry_time_us = 5000000,
};

static int transmit(uint32_t handle, void *data, size_t data_len, uint8_t tx_power, uint8_t mcs)
{
	uint32_t pkt_len = (data_len <= 32) ? 0x03 : ((data_len <= 64) ? 0x07 : 0x0F);
	struct phy_ctrl_field_common header = {
		.header_format = 0x0,
		.packet_length_type = 0x0,
		.packet_length = pkt_len,
		.short_network_id = (CONFIG_NETWORK_ID & 0xff),
		.transmitter_id_hi = (topo_device_id() >> 8),
		.transmitter_id_lo = (topo_device_id() & 0xff),
		.transmit_power = tx_power,
		.reserved = 0,
		.df_mcs = mcs,
	};

	struct nrf_modem_dect_phy_tx_params tx_op_params = {
		.start_time = 0,
		.handle = handle,
		.network_id = CONFIG_NETWORK_ID,
		.phy_type = 0,
		.lbt_rssi_threshold_max = 0,
		.carrier = CONFIG_CARRIER,
		.lbt_period = NRF_MODEM_DECT_LBT_PERIOD_MAX,
		.phy_header = (union nrf_modem_dect_phy_hdr *)&header,
		.data = data,
		.data_size = data_len,
	};

	return nrf_modem_dect_phy_tx(&tx_op_params);
}

static int receive(uint32_t handle)
{
	struct nrf_modem_dect_phy_rx_params rx_op_params = {
		.start_time = 0,
		.handle = handle,
		.network_id = CONFIG_NETWORK_ID,
		.mode = NRF_MODEM_DECT_PHY_RX_MODE_CONTINUOUS,
		.rssi_interval = NRF_MODEM_DECT_PHY_RSSI_INTERVAL_OFF,
		.link_id = NRF_MODEM_DECT_PHY_LINK_UNSPECIFIED,
		.rssi_level = -60,
		.carrier = CONFIG_CARRIER,
		.duration = CONFIG_RX_PERIOD_S * MSEC_PER_SEC *
			    NRF_MODEM_DECT_MODEM_TIME_TICK_RATE_KHZ,
		.filter.short_network_id = CONFIG_NETWORK_ID & 0xff,
		.filter.is_short_network_id_used = 1,
		.filter.receiver_identity = CONFIG_TOPO_DEST_RECEIVER_ID,
	};

	return nrf_modem_dect_phy_rx(&rx_op_params);
}

static void resolve_device_id(void)
{
	uint16_t id;

#if IS_ENABLED(CONFIG_TOPO_DEVICE_ID_OVERRIDE)
	id = (uint16_t)CONFIG_TOPO_DEVICE_ID;
#else
	hwinfo_get_device_id((void *)&id, sizeof(id));
#endif
	topo_set_device_id(id);
}

static int send_buf(uint32_t tx_handle, uint8_t *tx_buf, uint16_t tx_len)
{
	struct topo_runtime *rt = topo_runtime_get();
	uint8_t tx_power;
	uint8_t mcs;
	int err;

	topo_runtime_lock();
	tx_power = rt->tx_power;
	mcs = rt->mcs;
	topo_runtime_unlock();

	err = transmit(tx_handle, tx_buf, tx_len, tx_power, mcs);
	if (err) {
		LOG_ERR("Transmission failed, err %d", err);
		return err;
	}
	return 0;
}

static int send_hello(uint32_t tx_handle, uint8_t *tx_buf)
{
	struct topo_runtime *rt = topo_runtime_get();
	struct topo_packet *pkt = (struct topo_packet *)tx_buf;
	uint16_t tx_len;
	int err;

	topo_runtime_lock();
	tx_len = rt->packet_size;
	topo_runtime_unlock();

	if (tx_len < sizeof(*pkt) || tx_len > DATA_LEN_MAX) {
		return -EINVAL;
	}

	memset(tx_buf, 0, DATA_LEN_MAX);
	pkt->src = topo_device_id();
	pkt->dst = 0;
	pkt->prev_hop = topo_device_id();
	pkt->message_type = TOPO_MSG_HELLO;
	pkt->hop_count = 0;
	pkt->flags = 0;
	pkt->sequence = 0;
	pkt->tx_time_ms = (uint32_t)k_uptime_get();
	topo_packet_finalize(pkt);

	LOG_INF("TX: node=%u type=HELLO size=%u time=%u", topo_device_id(), tx_len,
		pkt->tx_time_ms);

	err = send_buf(tx_handle, tx_buf, tx_len);
	if (err) {
		return err;
	}

	topo_runtime_lock();
	rt->hello_sent++;
	topo_runtime_unlock();
	return 0;
}

static int send_data(uint32_t tx_handle, uint8_t *tx_buf)
{
	struct topo_runtime *rt = topo_runtime_get();
	struct topo_packet *pkt = (struct topo_packet *)tx_buf;
	uint32_t sequence;
	uint16_t tx_len;
	uint16_t dest;
	int err;

	topo_runtime_lock();
	sequence = rt->sequence;
	tx_len = rt->packet_size;
	dest = rt->dest_id;
	topo_runtime_unlock();

	if (dest == 0) {
		LOG_ERR("dest_id unset");
		return -EINVAL;
	}
	if (tx_len < sizeof(*pkt) || tx_len > DATA_LEN_MAX) {
		LOG_ERR("invalid packet size %u", tx_len);
		return -EINVAL;
	}

	memset(tx_buf, 0, DATA_LEN_MAX);
	pkt->src = topo_device_id();
	pkt->dst = dest;
	pkt->prev_hop = topo_device_id();
	pkt->message_type = TOPO_MSG_DATA;
	pkt->hop_count = 0;
	pkt->flags = 0;
	pkt->sequence = sequence;
	pkt->tx_time_ms = (uint32_t)k_uptime_get();
	topo_packet_finalize(pkt);

	uint64_t tx_time_us = (uint64_t)k_ticks_to_us_near64(k_uptime_ticks());

	LOG_INF("TX: node=%u type=DATA seq=%u src=%u dst=%u hop=0 size=%u time=%u time_us=%llu",
		topo_device_id(), pkt->sequence, pkt->src, pkt->dst, tx_len, pkt->tx_time_ms,
		(unsigned long long)tx_time_us);

	err = send_buf(tx_handle, tx_buf, tx_len);
	if (err) {
		return err;
	}

	topo_runtime_lock();
	rt->sequence++;
	rt->data_sent++;
	topo_runtime_unlock();
	return 0;
}

static int send_forward(uint32_t tx_handle, uint8_t *tx_buf, const struct topo_packet *fwd)
{
	struct topo_runtime *rt = topo_runtime_get();
	struct topo_packet *pkt = (struct topo_packet *)tx_buf;
	uint16_t tx_len;
	int err;

	topo_runtime_lock();
	tx_len = rt->packet_size;
	topo_runtime_unlock();

	if (tx_len < sizeof(*pkt) || tx_len > DATA_LEN_MAX) {
		return -EINVAL;
	}

	memset(tx_buf, 0, DATA_LEN_MAX);
	*pkt = *fwd;
	topo_packet_finalize(pkt);

	LOG_INF("FORWARD: node=%u seq=%u src=%u dst=%u prev=%u hop=%u size=%u", topo_device_id(),
		pkt->sequence, pkt->src, pkt->dst, pkt->prev_hop, pkt->hop_count, tx_len);

	err = send_buf(tx_handle, tx_buf, tx_len);
	if (err) {
		return err;
	}

	topo_runtime_lock();
	rt->fwd_sent++;
	topo_runtime_unlock();
	return 0;
}

static bool maybe_hello(uint32_t tx_handle, uint8_t *tx_buf)
{
	struct topo_runtime *rt = topo_runtime_get();
	uint32_t hello_ms;
	int64_t now = k_uptime_get();

	topo_runtime_lock();
	hello_ms = rt->hello_interval_ms;
	topo_runtime_unlock();

	if (hello_ms == 0) {
		return false;
	}
	if (last_hello_ms != 0 && (now - last_hello_ms) < (int64_t)hello_ms) {
		return false;
	}

	if (send_hello(tx_handle, tx_buf) == 0) {
		last_hello_ms = now;
		k_sem_take(&operation_sem, K_FOREVER);
		return true;
	}
	return false;
}

static int drain_forwards(uint32_t tx_handle, uint8_t *tx_buf)
{
	struct topo_fwd_item item;
	int n = 0;

	while (topo_fwd_dequeue(&item)) {
		if (send_forward(tx_handle, tx_buf, &item.pkt)) {
			return -EIO;
		}
		k_sem_take(&operation_sem, K_FOREVER);
		n++;
		if (!topo_is_running()) {
			break;
		}
	}
	return n >= 0 ? 0 : -EIO;
}

static void radio_thread_fn(void *p1, void *p2, void *p3)
{
	ARG_UNUSED(p1);
	ARG_UNUSED(p2);
	ARG_UNUSED(p3);

	uint32_t tx_handle = 0;
	uint32_t rx_handle = 1;
	uint8_t tx_buf[DATA_LEN_MAX];
	struct topo_runtime *rt = topo_runtime_get();

	while (1) {
		topo_wait_until_start();
		last_hello_ms = 0;
		LOG_INF("run active role=%s", topo_role_str(rt->role));

		while (topo_is_running()) {
			int err;
			enum topo_role role;
			uint32_t interval;
			uint32_t count;
			uint32_t sent;

			topo_runtime_lock();
			role = rt->role;
			interval = rt->tx_interval_ms;
			count = rt->tx_count;
			sent = rt->data_sent;
			topo_runtime_unlock();

			maybe_hello(tx_handle, tx_buf);
			if (!topo_is_running()) {
				topo_print_summary("stop");
				break;
			}

			err = drain_forwards(tx_handle, tx_buf);
			if (err) {
				topo_request_stop();
				topo_print_summary("tx_error");
				break;
			}
			if (!topo_is_running()) {
				topo_print_summary("stop");
				break;
			}

			if (role == TOPO_ROLE_SOURCE_V) {
				err = send_data(tx_handle, tx_buf);
				if (err) {
					topo_request_stop();
					topo_print_summary("tx_error");
					break;
				}
				k_sem_take(&operation_sem, K_FOREVER);

				topo_runtime_lock();
				sent = rt->data_sent;
				count = rt->tx_count;
				topo_runtime_unlock();

				if (count && sent >= count) {
					topo_request_stop();
					topo_print_summary("count_reached");
					LOG_INF("Reached DATA count (%u)", count);
					break;
				}
			}

			if (!topo_is_running()) {
				topo_print_summary("stop");
				break;
			}

			bool do_rx = true;
			if (role == TOPO_ROLE_SOURCE_V) {
				topo_runtime_lock();
				do_rx = rt->source_rx;
				topo_runtime_unlock();
			}

			if (do_rx) {
				/* All roles listen so neighbors / delivers / forwards can arrive. */
				err = receive(rx_handle);
				if (err) {
					LOG_ERR("Reception failed, err %d", err);
					topo_request_stop();
					topo_print_summary("rx_error");
					break;
				}
				k_sem_take(&operation_sem, K_FOREVER);
			}

			if (!topo_is_running()) {
				topo_print_summary("stop");
				break;
			}

			/* Flush any packets queued during RX before next cycle. */
			err = drain_forwards(tx_handle, tx_buf);
			if (err) {
				topo_request_stop();
				topo_print_summary("tx_error");
				break;
			}

			if (role == TOPO_ROLE_SOURCE_V && interval > 0) {
				k_sleep(K_MSEC(interval));
			}
		}
	}
}

static K_THREAD_STACK_DEFINE(radio_stack, RADIO_STACK_SIZE);
static struct k_thread radio_thread_data;

int main(void)
{
	int err;

	topo_runtime_init();

	LOG_INF("NR+ Topology Firmware (03_topology)");
	LOG_INF("default_role=%s carrier=%d net=0x%x wait_for_start=%d",
		topo_role_str(topo_runtime_get()->role), CONFIG_CARRIER, CONFIG_NETWORK_ID,
		IS_ENABLED(CONFIG_TOPO_WAIT_FOR_START));

	err = nrf_modem_lib_init();
	if (err) {
		LOG_ERR("modem init failed, err %d", err);
		return err;
	}

	err = nrf_modem_dect_phy_event_handler_set(dect_phy_event_handler);
	if (err) {
		LOG_ERR("nrf_modem_dect_phy_event_handler_set failed, err %d", err);
		return err;
	}

	err = nrf_modem_dect_phy_init();
	if (err) {
		LOG_ERR("nrf_modem_dect_phy_init failed, err %d", err);
		return err;
	}

	k_sem_take(&operation_sem, K_FOREVER);
	if (phy_fatal) {
		return -EIO;
	}

	err = nrf_modem_dect_phy_configure(&dect_phy_config_params);
	if (err) {
		LOG_ERR("nrf_modem_dect_phy_configure failed, err %d", err);
		return err;
	}

	k_sem_take(&operation_sem, K_FOREVER);
	if (phy_fatal) {
		return -EIO;
	}

	err = nrf_modem_dect_phy_activate(NRF_MODEM_DECT_PHY_RADIO_MODE_LOW_LATENCY);
	if (err) {
		LOG_ERR("nrf_modem_dect_phy_activate failed, err %d", err);
		return err;
	}

	k_sem_take(&operation_sem, K_FOREVER);
	if (phy_fatal) {
		return -EIO;
	}

	resolve_device_id();
	LOG_INF("device_id=%u (0x%04x)", topo_device_id(), topo_device_id());

	if (IS_ENABLED(CONFIG_TOPO_PERSIST)) {
		(void)topo_persist_load();
	}

	LOG_INF("Commands: exp status|role|sett|start|stop|neigh|save|load|factory|autostart");

	err = nrf_modem_dect_phy_capability_get();
	if (err) {
		LOG_ERR("nrf_modem_dect_phy_capability_get failed, err %d", err);
	}

	k_thread_create(&radio_thread_data, radio_stack, RADIO_STACK_SIZE, radio_thread_fn, NULL,
			NULL, NULL, 5, 0, K_NO_WAIT);
	k_thread_name_set(&radio_thread_data, "topo_radio");

	if (topo_should_autostart()) {
		enum topo_role role;
		uint16_t dest;

		topo_runtime_lock();
		role = topo_runtime_get()->role;
		dest = topo_runtime_get()->dest_id;
		topo_runtime_unlock();

		if (role == TOPO_ROLE_SOURCE_V && dest == 0) {
			LOG_WRN("autostart skipped: source needs dest_id (exp sett dest + exp save)");
			LOG_INF("waiting for: exp start");
		} else {
			topo_request_start(UINT32_MAX);
			LOG_INF("auto-start enabled (role=%s dest=%u)", topo_role_str(role), dest);
			printk("persist: auto-start role=%s dest=%u\n", topo_role_str(role), dest);
		}
	} else {
		LOG_INF("waiting for: exp start");
	}

	return 0;
}
```

## src/topo_packet.h
```c
/*
 * Copyright (c) 2026 Conexio Technologies, Inc
 *
 * SPDX-License-Identifier: Apache-2.0
 *
 * Week 3 topology — on-air application PDU (PHY broadcast).
 */

#ifndef TOPO_PACKET_H_
#define TOPO_PACKET_H_

#include <stdbool.h>
#include <stddef.h>
#include <stdint.h>

/** End-to-end application probe (source → destination). */
#define TOPO_MSG_DATA 1
/** Neighbor advertisement (dst ignored / broadcast). */
#define TOPO_MSG_HELLO 2

/**
 * Packed application PDU in the DECT PHY PDC.
 *
 * Routing note: next_hop is local state only; on air we carry prev_hop
 * (who transmitted this hop) plus hop_count for path reconstruction.
 *
 * Clocks: tx_time_ms is sender k_uptime_get() — not synchronized.
 * Checksum: XOR of all bytes before the checksum field.
 */
struct topo_packet {
	uint16_t src;
	uint16_t dst;
	uint16_t prev_hop;
	uint8_t message_type;
	uint8_t hop_count;
	uint8_t flags;
	uint32_t sequence;
	uint32_t tx_time_ms;
	uint8_t checksum;
} __attribute__((packed));

/* Expected sizeof(struct topo_packet) == 18 */

static inline uint8_t topo_checksum(const void *data, size_t len)
{
	const uint8_t *b = data;
	uint8_t cs = 0;

	for (size_t i = 0; i < len; i++) {
		cs ^= b[i];
	}
	return cs;
}

static inline void topo_packet_finalize(struct topo_packet *pkt)
{
	pkt->checksum = 0;
	pkt->checksum = topo_checksum(pkt, sizeof(*pkt) - 1);
}

static inline bool topo_packet_verify(const struct topo_packet *pkt)
{
	uint8_t expect = topo_checksum(pkt, sizeof(*pkt) - 1);

	return pkt->checksum == expect;
}

#endif /* TOPO_PACKET_H_ */
```

## src/topo_persist.c
```c
/*
 * Copyright (c) 2026 Conexio Technologies, Inc
 *
 * SPDX-License-Identifier: Apache-2.0
 *
 * Persist topology role / RF / autostart across reset using Zephyr settings (NVS).
 */

#include "topo_persist.h"

#include "topo_runtime.h"

#include <errno.h>
#include <string.h>
#include <zephyr/kernel.h>
#include <zephyr/logging/log.h>
#include <zephyr/settings/settings.h>
#include <zephyr/sys/printk.h>

LOG_MODULE_REGISTER(topo_persist, CONFIG_DECT_PHY_TOPO_LOG_LEVEL);

#define TOPO_PERSIST_MAGIC   0x4F504F54u /* 'TOPO' */
#define TOPO_PERSIST_VERSION 2u
#define TOPO_PERSIST_KEY     "topo/cfg"

struct topo_persist_cfg {
	uint32_t magic;
	uint16_t version;
	uint8_t autostart;
	uint8_t role;
	uint16_t dest_id;
	uint8_t max_hops;
	uint8_t tx_power;
	uint8_t mcs;
	uint16_t packet_size;
	uint32_t tx_interval_ms;
	uint32_t hello_interval_ms;
	uint32_t tx_count;
	uint8_t dedup;
	uint8_t source_rx;
	uint8_t reserved[7];
} __packed;

BUILD_ASSERT(sizeof(struct topo_persist_cfg) == 36, "persist blob size");

static bool g_autostart;
static bool g_present;
static struct topo_persist_cfg g_loaded;
static bool g_have_loaded_blob;

static int persist_set_handler(const char *name, size_t len, settings_read_cb read_cb, void *cb_arg)
{
	const char *next;
	int rc;
	ssize_t n;

	if (settings_name_steq(name, "cfg", &next) && !next) {
		if (len != sizeof(g_loaded)) {
			LOG_WRN("topo/cfg size mismatch %u vs %u", (unsigned)len,
				(unsigned)sizeof(g_loaded));
			return -EINVAL;
		}
		n = read_cb(cb_arg, &g_loaded, sizeof(g_loaded));
		if (n < 0) {
			return (int)n;
		}
		if ((size_t)n != sizeof(g_loaded)) {
			return -EINVAL;
		}
		if (g_loaded.magic != TOPO_PERSIST_MAGIC ||
		    (g_loaded.version != TOPO_PERSIST_VERSION && g_loaded.version != 1u)) {
			LOG_WRN("topo/cfg bad magic/version");
			return -EINVAL;
		}
		g_have_loaded_blob = true;
		return 0;
	}

	return -ENOENT;
}

SETTINGS_STATIC_HANDLER_DEFINE(topo, "topo", NULL, persist_set_handler, NULL, NULL);

static void apply_blob_to_runtime(const struct topo_persist_cfg *cfg)
{
	struct topo_runtime *rt = topo_runtime_get();

	topo_runtime_lock();
	rt->role = (enum topo_role)cfg->role;
	rt->dest_id = cfg->dest_id;
	rt->max_hops = cfg->max_hops;
	rt->tx_power = cfg->tx_power;
	rt->mcs = cfg->mcs;
	rt->packet_size = cfg->packet_size;
	rt->tx_interval_ms = cfg->tx_interval_ms;
	rt->hello_interval_ms = cfg->hello_interval_ms;
	rt->tx_count = cfg->tx_count;
	rt->dedup = cfg->dedup != 0;
	if (cfg->version >= 2u) {
		rt->source_rx = cfg->source_rx != 0;
	} else {
		rt->source_rx = true;
	}
	topo_runtime_unlock();

	g_autostart = cfg->autostart != 0;
	g_present = true;
}

static void fill_blob_from_runtime(struct topo_persist_cfg *cfg)
{
	struct topo_runtime *rt = topo_runtime_get();

	memset(cfg, 0, sizeof(*cfg));
	cfg->magic = TOPO_PERSIST_MAGIC;
	cfg->version = TOPO_PERSIST_VERSION;
	cfg->autostart = g_autostart ? 1U : 0U;

	topo_runtime_lock();
	cfg->role = (uint8_t)rt->role;
	cfg->dest_id = rt->dest_id;
	cfg->max_hops = rt->max_hops;
	cfg->tx_power = rt->tx_power;
	cfg->mcs = rt->mcs;
	cfg->packet_size = rt->packet_size;
	cfg->tx_interval_ms = rt->tx_interval_ms;
	cfg->hello_interval_ms = rt->hello_interval_ms;
	cfg->tx_count = rt->tx_count;
	cfg->dedup = rt->dedup ? 1U : 0U;
	cfg->source_rx = rt->source_rx ? 1U : 0U;
	topo_runtime_unlock();
}

bool topo_persist_load(void)
{
	int rc;

	g_have_loaded_blob = false;
	g_present = false;

	rc = settings_subsys_init();
	if (rc && rc != -EALREADY) {
		LOG_ERR("settings_subsys_init failed %d", rc);
		return false;
	}

	rc = settings_load();
	if (rc) {
		LOG_WRN("settings_load failed %d", rc);
		return false;
	}

	if (!g_have_loaded_blob) {
		LOG_INF("no saved topology profile");
		return false;
	}

	if (g_loaded.role > TOPO_ROLE_SINK_V) {
		LOG_WRN("invalid saved role %u", g_loaded.role);
		return false;
	}
	if (g_loaded.packet_size < sizeof(struct topo_packet) || g_loaded.packet_size > 128) {
		LOG_WRN("invalid saved size %u", g_loaded.packet_size);
		return false;
	}
	if (g_loaded.max_hops < 1 || g_loaded.max_hops > 16) {
		LOG_WRN("invalid saved max_hops %u", g_loaded.max_hops);
		return false;
	}
	if (g_loaded.tx_power > 13 || g_loaded.mcs > 7) {
		LOG_WRN("invalid saved RF params");
		return false;
	}

	apply_blob_to_runtime(&g_loaded);
	LOG_INF("loaded profile role=%s dest=%u autostart=%u", topo_role_str(g_loaded.role),
		g_loaded.dest_id, g_loaded.autostart);
	printk("persist: loaded role=%s dest=%u power=%u autostart=%u dedup=%u source_rx=%u\n",
	       topo_role_str((enum topo_role)g_loaded.role), g_loaded.dest_id, g_loaded.tx_power,
	       g_loaded.autostart, g_loaded.dedup, g_loaded.source_rx);
	return true;
}

int topo_persist_save(void)
{
	struct topo_persist_cfg cfg;
	int rc;

	rc = settings_subsys_init();
	if (rc && rc != -EALREADY) {
		return rc;
	}

	fill_blob_from_runtime(&cfg);
	rc = settings_save_one(TOPO_PERSIST_KEY, &cfg, sizeof(cfg));
	if (rc) {
		LOG_ERR("settings_save_one failed %d", rc);
		return rc;
	}

	g_loaded = cfg;
	g_have_loaded_blob = true;
	g_present = true;
	LOG_INF("saved profile role=%s dest=%u autostart=%u", topo_role_str(cfg.role), cfg.dest_id,
		cfg.autostart);
	return 0;
}

int topo_persist_clear(void)
{
	int rc;

	rc = settings_subsys_init();
	if (rc && rc != -EALREADY) {
		return rc;
	}

	rc = settings_delete(TOPO_PERSIST_KEY);
	if (rc && rc != -ENOENT) {
		LOG_ERR("settings_delete failed %d", rc);
		return rc;
	}

	g_present = false;
	g_have_loaded_blob = false;
	g_autostart = false;
	memset(&g_loaded, 0, sizeof(g_loaded));
	LOG_INF("cleared saved topology profile");
	return 0;
}

bool topo_persist_present(void)
{
	return g_present;
}

bool topo_autostart_get(void)
{
	return g_autostart;
}

void topo_autostart_set(bool on)
{
	g_autostart = on;
}
```

## src/topo_persist.h
```c
/*
 * Copyright (c) 2026 Conexio Technologies, Inc
 *
 * SPDX-License-Identifier: Apache-2.0
 */

#ifndef TOPO_PERSIST_H_
#define TOPO_PERSIST_H_

#include <stdbool.h>
#include <stdint.h>

/**
 * Load saved profile from flash into runtime (after topo_runtime_init defaults).
 * @return true if a valid profile was loaded
 */
bool topo_persist_load(void);

/** Save current runtime settings + autostart flag to flash. @return 0 on success */
int topo_persist_save(void);

/** Erase saved profile (factory). @return 0 on success */
int topo_persist_clear(void);

bool topo_persist_present(void);
bool topo_autostart_get(void);
void topo_autostart_set(bool on);

#endif /* TOPO_PERSIST_H_ */
```

## src/topo_runtime.c
```c
/*
 * Copyright (c) 2026 Conexio Technologies, Inc
 *
 * SPDX-License-Identifier: Apache-2.0
 */

#include "topo_runtime.h"

#include <limits.h>
#include <string.h>
#include <zephyr/kernel.h>
#include <zephyr/sys/printk.h>
#include <zephyr/sys/util.h>

#if IS_ENABLED(CONFIG_TOPO_PERSIST)
#include "topo_persist.h"
#endif

static struct topo_runtime rt;
static uint16_t g_device_id;
static struct k_mutex rt_lock;
static struct k_sem start_sem;

K_MSGQ_DEFINE(fwd_q, sizeof(struct topo_fwd_item), TOPO_FWD_QUEUE_MAX, 4);

static enum topo_role default_role(void)
{
	if (IS_ENABLED(CONFIG_TOPO_ROLE_RELAY)) {
		return TOPO_ROLE_RELAY_V;
	}
	if (IS_ENABLED(CONFIG_TOPO_ROLE_SINK)) {
		return TOPO_ROLE_SINK_V;
	}
	return TOPO_ROLE_SOURCE_V;
}

static void reset_stats_locked(void)
{
	rt.sequence = 0;
	rt.data_sent = 0;
	rt.hello_sent = 0;
	rt.fwd_sent = 0;
	rt.rx_ok = 0;
	rt.rx_fail = 0;
	rt.deliver_ok = 0;
	rt.fwd_drop_dup = 0;
	rt.fwd_drop_ttl = 0;
	rt.fwd_enqueue = 0;
	rt.fwd_drop_full = 0;
	rt.last_from = 0;
	rt.rssi_min_x2 = INT32_MAX;
	rt.rssi_max_x2 = INT32_MIN;
	rt.rssi_sum_x2 = 0;
	rt.rssi_n = 0;
	rt.q_depth_peak = 0;
	memset(rt.seen, 0, sizeof(rt.seen));
	/* Keep neighbors across start so Exp1 map persists; clear on demand later if needed. */
}

void topo_runtime_init(void)
{
	k_mutex_init(&rt_lock);
	k_sem_init(&start_sem, 0, 1);
	topo_runtime_restore_defaults();
}

void topo_runtime_restore_defaults(void)
{
	k_mutex_lock(&rt_lock, K_FOREVER);
	rt.running = false;
	rt.role = default_role();
	rt.dest_id = (uint16_t)CONFIG_TOPO_DEST_ID;
	rt.max_hops = (uint8_t)CONFIG_TOPO_MAX_HOPS;
	rt.tx_interval_ms = CONFIG_TX_INTERVAL_MS;
	rt.hello_interval_ms = CONFIG_HELLO_INTERVAL_MS;
	rt.tx_count = CONFIG_TX_TRANSMISSIONS;
	rt.tx_power = (uint8_t)CONFIG_TX_POWER;
	rt.mcs = (uint8_t)CONFIG_MCS;
	rt.packet_size = (uint16_t)CONFIG_TOPO_PACKET_SIZE;
	rt.dedup = IS_ENABLED(CONFIG_TOPO_DEDUP);
	rt.source_rx = true;
	memset(rt.neigh, 0, sizeof(rt.neigh));
	reset_stats_locked();
	k_mutex_unlock(&rt_lock);
}

struct topo_runtime *topo_runtime_get(void)
{
	return &rt;
}

void topo_runtime_lock(void)
{
	k_mutex_lock(&rt_lock, K_FOREVER);
}

void topo_runtime_unlock(void)
{
	k_mutex_unlock(&rt_lock);
}

void topo_set_device_id(uint16_t id)
{
	g_device_id = id;
}

uint16_t topo_device_id(void)
{
	return g_device_id;
}

const char *topo_role_str(enum topo_role role)
{
	switch (role) {
	case TOPO_ROLE_SOURCE_V:
		return "source";
	case TOPO_ROLE_RELAY_V:
		return "relay";
	case TOPO_ROLE_SINK_V:
		return "sink";
	default:
		return "unknown";
	}
}

bool topo_role_from_str(const char *s, enum topo_role *out)
{
	if (strcmp(s, "source") == 0 || strcmp(s, "src") == 0) {
		*out = TOPO_ROLE_SOURCE_V;
		return true;
	}
	if (strcmp(s, "relay") == 0 || strcmp(s, "router") == 0) {
		*out = TOPO_ROLE_RELAY_V;
		return true;
	}
	if (strcmp(s, "sink") == 0 || strcmp(s, "gateway") == 0) {
		*out = TOPO_ROLE_SINK_V;
		return true;
	}
	return false;
}

void topo_runtime_reset_stats(void)
{
	k_mutex_lock(&rt_lock, K_FOREVER);
	reset_stats_locked();
	k_mutex_unlock(&rt_lock);
}

void topo_request_start(uint32_t count_override)
{
	struct topo_fwd_item discard;

	k_mutex_lock(&rt_lock, K_FOREVER);
	if (count_override != UINT32_MAX) {
		rt.tx_count = count_override;
	}
	reset_stats_locked();
	rt.running = true;
	k_mutex_unlock(&rt_lock);

	while (k_msgq_get(&fwd_q, &discard, K_NO_WAIT) == 0) {
		/* drain stale forwards */
	}
	k_sem_give(&start_sem);
}

void topo_request_stop(void)
{
	k_mutex_lock(&rt_lock, K_FOREVER);
	rt.running = false;
	k_mutex_unlock(&rt_lock);
	k_sem_give(&start_sem);
}

bool topo_is_running(void)
{
	bool r;

	k_mutex_lock(&rt_lock, K_FOREVER);
	r = rt.running;
	k_mutex_unlock(&rt_lock);
	return r;
}

void topo_wait_until_start(void)
{
	while (!topo_is_running()) {
		k_sem_take(&start_sem, K_FOREVER);
	}
}

void topo_neigh_note(uint16_t id, int32_t rssi_x2, uint8_t msg_type)
{
	struct topo_neighbor *slot = NULL;
	struct topo_neighbor *free_slot = NULL;
	uint32_t oldest_ms = UINT32_MAX;
	struct topo_neighbor *oldest = NULL;
	uint32_t now = (uint32_t)k_uptime_get();

	if (id == 0 || id == g_device_id) {
		return;
	}

	k_mutex_lock(&rt_lock, K_FOREVER);

	for (int i = 0; i < TOPO_NEIGH_MAX; i++) {
		if (rt.neigh[i].used && rt.neigh[i].id == id) {
			slot = &rt.neigh[i];
			break;
		}
		if (!rt.neigh[i].used && free_slot == NULL) {
			free_slot = &rt.neigh[i];
		}
		if (rt.neigh[i].used && rt.neigh[i].last_seen_ms < oldest_ms) {
			oldest_ms = rt.neigh[i].last_seen_ms;
			oldest = &rt.neigh[i];
		}
	}

	if (slot == NULL) {
		slot = free_slot != NULL ? free_slot : oldest;
		if (slot == NULL) {
			k_mutex_unlock(&rt_lock);
			return;
		}
		slot->used = true;
		slot->id = id;
		slot->hello_n = 0;
		slot->data_n = 0;
	}

	slot->last_rssi_x2 = rssi_x2;
	slot->last_seen_ms = now;
	if (msg_type == TOPO_MSG_HELLO) {
		slot->hello_n++;
	} else if (msg_type == TOPO_MSG_DATA) {
		slot->data_n++;
	}

	k_mutex_unlock(&rt_lock);
}

bool topo_seen_is_dup(uint16_t src, uint32_t sequence)
{
	struct topo_seen *slot = NULL;
	struct topo_seen *free_slot = NULL;

	k_mutex_lock(&rt_lock, K_FOREVER);

	/* When dedup is disabled, always treat as new. */
	if (!rt.dedup) {
		k_mutex_unlock(&rt_lock);
		return false;
	}

	for (int i = 0; i < TOPO_SEEN_MAX; i++) {
		if (rt.seen[i].used && rt.seen[i].src == src && rt.seen[i].sequence == sequence) {
			rt.fwd_drop_dup++;
			k_mutex_unlock(&rt_lock);
			return true;
		}
		if (!rt.seen[i].used && free_slot == NULL) {
			free_slot = &rt.seen[i];
		}
		if (rt.seen[i].used && slot == NULL) {
			/* overwrite candidate if table full */
			slot = &rt.seen[i];
		}
	}

	if (free_slot != NULL) {
		free_slot->used = true;
		free_slot->src = src;
		free_slot->sequence = sequence;
	} else if (slot != NULL) {
		slot->src = src;
		slot->sequence = sequence;
	}

	k_mutex_unlock(&rt_lock);
	return false;
}

bool topo_fwd_enqueue(const struct topo_packet *pkt)
{
	struct topo_fwd_item item = { .pkt = *pkt };
	int err;

	err = k_msgq_put(&fwd_q, &item, K_NO_WAIT);
	k_mutex_lock(&rt_lock, K_FOREVER);
	if (err) {
		rt.fwd_drop_full++;
		k_mutex_unlock(&rt_lock);
		return false;
	}
	rt.fwd_enqueue++;
	uint16_t depth = (uint16_t)k_msgq_num_used_get(&fwd_q);
	if (depth > rt.q_depth_peak) {
		rt.q_depth_peak = depth;
	}
	k_mutex_unlock(&rt_lock);
	return true;
}

bool topo_fwd_dequeue(struct topo_fwd_item *out)
{
	return k_msgq_get(&fwd_q, out, K_NO_WAIT) == 0;
}

void topo_print_status(void)
{
	struct topo_runtime snap;

	k_mutex_lock(&rt_lock, K_FOREVER);
	snap = rt;
	k_mutex_unlock(&rt_lock);

	printk("exp status:\n");
	printk("  role=%s running=%d device_id=%u dest_id=%u max_hops=%u\n",
	       topo_role_str(snap.role), snap.running, g_device_id, snap.dest_id, snap.max_hops);
	printk("  carrier=%d net=0x%x\n", CONFIG_CARRIER, CONFIG_NETWORK_ID);
	printk("  interval_ms=%u hello_ms=%u count=%u (0=forever)\n", snap.tx_interval_ms,
	       snap.hello_interval_ms, snap.tx_count);
	printk("  power=%u mcs=%u size=%u dedup=%d source_rx=%d\n", snap.tx_power, snap.mcs, snap.packet_size,
	       snap.dedup ? 1 : 0, snap.source_rx ? 1 : 0);
#if IS_ENABLED(CONFIG_TOPO_PERSIST)
	printk("  autostart=%d persist=%d\n", topo_autostart_get() ? 1 : 0,
	       topo_persist_present() ? 1 : 0);
#endif
	printk("  seq_next=%u data_sent=%u hello_sent=%u fwd_sent=%u\n", snap.sequence,
	       snap.data_sent, snap.hello_sent, snap.fwd_sent);
	printk("  rx_ok=%u rx_fail=%u deliver=%u fwd_dup=%u fwd_ttl=%u fwd_qfull=%u q_peak=%u\n",
	       snap.rx_ok, snap.rx_fail, snap.deliver_ok, snap.fwd_drop_dup, snap.fwd_drop_ttl,
	       snap.fwd_drop_full, snap.q_depth_peak);
}

bool topo_should_autostart(void)
{
	/* Kconfig overlay can force auto-start without NVS. */
	if (!IS_ENABLED(CONFIG_TOPO_WAIT_FOR_START)) {
		return true;
	}
#if IS_ENABLED(CONFIG_TOPO_PERSIST)
	return topo_autostart_get();
#else
	return false;
#endif
}

void topo_print_neighbors(void)
{
	struct topo_neighbor snap[TOPO_NEIGH_MAX];
	int n = 0;

	k_mutex_lock(&rt_lock, K_FOREVER);
	memcpy(snap, rt.neigh, sizeof(snap));
	k_mutex_unlock(&rt_lock);

	printk("exp neigh:\n");
	for (int i = 0; i < TOPO_NEIGH_MAX; i++) {
		int rssi_i;
		int rssi_f;

		if (!snap[i].used) {
			continue;
		}
		n++;
		rssi_i = snap[i].last_rssi_x2 / 2;
		rssi_f = (snap[i].last_rssi_x2 & 1) * 5;
		printk("  id=%u rssi=%d.%d last_ms=%u hello=%u data=%u\n", snap[i].id, rssi_i,
		       rssi_f, snap[i].last_seen_ms, snap[i].hello_n, snap[i].data_n);
	}
	if (n == 0) {
		printk("  (none)\n");
	}
}

void topo_print_summary(const char *reason)
{
	struct topo_runtime snap;
	int avg_i = 0;
	int avg_f = 0;
	int min_i = 0;
	int min_f = 0;
	int max_i = 0;
	int max_f = 0;

	k_mutex_lock(&rt_lock, K_FOREVER);
	snap = rt;
	k_mutex_unlock(&rt_lock);

	if (snap.rssi_n > 0) {
		int32_t avg_x2 = (int32_t)(snap.rssi_sum_x2 / (int64_t)snap.rssi_n);

		avg_i = avg_x2 / 2;
		avg_f = (avg_x2 & 1) * 5;
		min_i = snap.rssi_min_x2 / 2;
		min_f = (snap.rssi_min_x2 & 1) * 5;
		max_i = snap.rssi_max_x2 / 2;
		max_f = (snap.rssi_max_x2 & 1) * 5;
	}

	printk("SUMMARY: role=%s reason=%s device_id=%u dest=%u data_sent=%u hello_sent=%u "
	       "fwd_sent=%u rx_ok=%u rx_fail=%u deliver=%u q_peak=%u "
	       "rssi_min=%d.%d rssi_avg=%d.%d rssi_max=%d.%d\n",
	       topo_role_str(snap.role), reason, g_device_id, snap.dest_id, snap.data_sent,
	       snap.hello_sent, snap.fwd_sent, snap.rx_ok, snap.rx_fail, snap.deliver_ok, snap.q_depth_peak,
	       min_i, min_f, avg_i, avg_f, max_i, max_f);
}
```

## src/topo_runtime.h
```c
/*
 * Copyright (c) 2026 Conexio Technologies, Inc
 *
 * SPDX-License-Identifier: Apache-2.0
 */

#ifndef TOPO_RUNTIME_H_
#define TOPO_RUNTIME_H_

#include "topo_packet.h"

#include <stdbool.h>
#include <stdint.h>

enum topo_role {
	TOPO_ROLE_SOURCE_V = 0,
	TOPO_ROLE_RELAY_V = 1,
	TOPO_ROLE_SINK_V = 2,
};

#define TOPO_NEIGH_MAX 8
#define TOPO_SEEN_MAX 16
#define TOPO_FWD_QUEUE_MAX 8

struct topo_neighbor {
	uint16_t id;
	int32_t last_rssi_x2;
	uint32_t last_seen_ms;
	uint32_t hello_n;
	uint32_t data_n;
	bool used;
};

struct topo_seen {
	uint16_t src;
	uint32_t sequence;
	bool used;
};

struct topo_runtime {
	bool running;
	enum topo_role role;
	uint16_t dest_id;
	uint8_t max_hops;

	uint32_t tx_interval_ms;
	uint32_t hello_interval_ms;
	uint32_t tx_count; /* source DATA count; 0 = forever */
	uint8_t tx_power;
	uint8_t mcs;
	uint16_t packet_size;
	bool dedup; /* relay duplicate detection on/off */
	bool source_rx; /* if true, source listens for 2s after TX. default true */
	uint16_t q_depth_peak; /* peak forwarding queue depth observed during run */

	uint32_t sequence;
	uint32_t data_sent;
	uint32_t hello_sent;
	uint32_t fwd_sent;
	uint32_t rx_ok;
	uint32_t rx_fail;
	uint32_t deliver_ok;
	uint32_t fwd_drop_dup;
	uint32_t fwd_drop_ttl;
	uint32_t fwd_enqueue;
	uint32_t fwd_drop_full;

	uint16_t last_from;
	int32_t rssi_min_x2;
	int32_t rssi_max_x2;
	int64_t rssi_sum_x2;
	uint32_t rssi_n;

	struct topo_neighbor neigh[TOPO_NEIGH_MAX];
	struct topo_seen seen[TOPO_SEEN_MAX];
};

struct topo_fwd_item {
	struct topo_packet pkt;
};

void topo_runtime_init(void);
/** Restore Kconfig defaults into RAM without re-initing locks (after factory clear). */
void topo_runtime_restore_defaults(void);
struct topo_runtime *topo_runtime_get(void);
void topo_runtime_lock(void);
void topo_runtime_unlock(void);

void topo_runtime_reset_stats(void);

void topo_request_start(uint32_t count_override);
void topo_request_stop(void);
bool topo_is_running(void);
void topo_wait_until_start(void);

void topo_print_status(void);
void topo_print_summary(const char *reason);
void topo_print_neighbors(void);

/** Whether a saved flash profile should auto-start after boot. */
bool topo_should_autostart(void);

const char *topo_role_str(enum topo_role role);
bool topo_role_from_str(const char *s, enum topo_role *out);

uint16_t topo_device_id(void);
void topo_set_device_id(uint16_t id);

/** Update / insert neighbor from a verified RX. Call with lock held or unlocked (locks internally). */
void topo_neigh_note(uint16_t id, int32_t rssi_x2, uint8_t msg_type);

/**
 * Duplicate check for (src, sequence). Returns true if already seen (should not forward).
 * Records this pair when not a duplicate. Call unlocked — locks internally.
 */
bool topo_seen_is_dup(uint16_t src, uint32_t sequence);

bool topo_fwd_enqueue(const struct topo_packet *pkt);
bool topo_fwd_dequeue(struct topo_fwd_item *out);

#endif /* TOPO_RUNTIME_H_ */
```
